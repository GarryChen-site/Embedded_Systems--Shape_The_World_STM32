// ssd1306_hal.c — SSD1306 OLED 128×64 driver (HAL version), Lab 16 IoT
//
// Uses HAL_I2C_Master_Transmit to control the SSD1306 OLED.

#include "ssd1306_hal.h"
#include <string.h>

extern I2C_HandleTypeDef hi2c1;

uint8_t ScreenBuffer[SCREENW * (SCREENH / 8)];
static uint8_t CursorX = 0; // 0..20
static uint8_t CursorY = 0; // 0..7

// Standard 5x8 ASCII Font Table
static const uint8_t Font5x8[][5] = {
    {0x00, 0x00, 0x00, 0x00, 0x00}, // space
    {0x00, 0x00, 0x5F, 0x00, 0x00}, // !
    {0x00, 0x07, 0x00, 0x07, 0x00}, // "
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    {0x1F, 0x24, 0x7C, 0x24, 0x1F}, // degree / UT symbol
};

// Send a stream of command bytes to the SSD1306 controller
static void ssd1306_cmd_stream(const uint8_t *cmds, uint16_t n) {
  uint8_t tx_buf[64];
  if (n + 1 > sizeof(tx_buf)) {
    return;
  }
  tx_buf[0] = 0x00U; // Control byte: Co=0, D/C#=0 (command stream)
  memcpy(&tx_buf[1], cmds, n);
  HAL_I2C_Master_Transmit(&hi2c1, SSD1306_I2C_ADDR, tx_buf, n + 1, 100);
}

void SSD1306_Init(void) {
  HAL_Delay(10);

  static const uint8_t init_cmds[] = {
      0xAE,             // Display OFF
      0x20, 0x00,       // Horizontal addressing mode
      0x21, 0x00, 0x7F, // Column address 0-127
      0x22, 0x00, 0x07, // Page address 0-7
      0x40,             // Start line = 0
      0xA1,             // Segment re-map (col 127 -> SEG0)
      0xA8, 0x3F,       // Multiplex ratio 64
      0xC8,             // COM scan reverse
      0xD3, 0x00,       // Display offset 0
      0xDA, 0x12,       // COM pins sequential
      0xD5, 0x80,       // Oscillator freq
      0xD9, 0xF1,       // Pre-charge
      0xDB, 0x40,       // VCOMH deselect
      0x81, 0xCF,       // Contrast
      0xA4,             // Entire display ON from RAM
      0xA6,             // Normal display
      0x8D, 0x14,       // Charge pump enable
      0xAF,             // Display ON
  };
  ssd1306_cmd_stream(init_cmds, sizeof(init_cmds));

  SSD1306_Clear();
}

void SSD1306_ClearBuffer(void) {
  memset(ScreenBuffer, 0, sizeof(ScreenBuffer));
}

void SSD1306_DisplayBuffer(void) {
  static const uint8_t addr_cmds[] = {
      0x21, 0x00, 0x7F, // Column 0-127
      0x22, 0x00, 0x07  // Page 0-7
  };
  ssd1306_cmd_stream(addr_cmds, sizeof(addr_cmds));

  // Send 1024 bytes of frame buffer in chunks with 0x40 control byte
  static uint8_t tx_chunk[129];
  tx_chunk[0] = 0x40U; // Control byte: D/C#=1 (data stream)

  for (uint32_t page = 0; page < 8; page++) {
    memcpy(&tx_chunk[1], &ScreenBuffer[page * 128], 128);
    HAL_I2C_Master_Transmit(&hi2c1, SSD1306_I2C_ADDR, tx_chunk, 129, 100);
  }
}

void SSD1306_Clear(void) {
  SSD1306_ClearBuffer();
  SSD1306_DisplayBuffer();
  CursorX = 0;
  CursorY = 0;
}

void SSD1306_SetCursor(uint8_t col, uint8_t row) {
  CursorX = col;
  CursorY = row & 0x07U;
}

void SSD1306_OutChar(char c) {
  if ((uint8_t)c < 0x20U || (uint8_t)c > 0x7FU) {
    c = ' ';
  }
  const uint8_t *glyph = Font5x8[(uint8_t)c - 0x20U];

  uint32_t col = (uint32_t)CursorX * 6U;
  uint32_t page = (uint32_t)CursorY;

  if (col + 6U > (uint32_t)SCREENW || page > 7U) {
    return;
  }

  for (uint8_t i = 0U; i < 5U; i++) {
    ScreenBuffer[page * (uint32_t)SCREENW + col + i] = glyph[i];
  }
  ScreenBuffer[page * (uint32_t)SCREENW + col + 5U] = 0x00U; // 1-px gap

  CursorX++;
  if ((uint32_t)CursorX * 6U >= (uint32_t)SCREENW) {
    CursorX = 0;
    if (CursorY < 7U) {
      CursorY++;
    }
  }
}

void SSD1306_OutString(const char *str) {
  if (!str) {
    return;
  }
  while (*str) {
    if (*str == '\n') {
      CursorX = 0;
      if (CursorY < 7U) {
        CursorY++;
        str++;
        continue;
      }
      SSD1306_OutChar(*str++);
    }
  }

  void SSD1306_OutUDec(uint16_t n) {
    char buf[6];
    uint8_t i = 5U;
    buf[5] = '\0';
    do {
      buf[--i] = (char)('0' + (n % 10U));
      n = (uint16_t)(n / 10U);
    } while (n && i > 0U);
    SSD1306_OutString(&buf[i]);
  }
