/* USER CODE BEGIN Header */
/**
 ******************************************************************************
 * @file           : main.c
 * @brief          : Main program body
 ******************************************************************************
 * @attention
 *
 * Copyright (c) 2026 STMicroelectronics.
 * All rights reserved.
 *
 * This software is licensed under terms that can be found in the LICENSE file
 * in the root directory of this software component.
 * If no LICENSE file comes with this software, it is provided AS-IS.
 *
 ******************************************************************************
 */
/* USER CODE END Header */
/* Includes ------------------------------------------------------------------*/
#include "main.h"

/* Private includes ----------------------------------------------------------*/
/* USER CODE BEGIN Includes */

/* USER CODE END Includes */

/* Private typedef -----------------------------------------------------------*/
/* USER CODE BEGIN PTD */

/* USER CODE END PTD */

/* Private define ------------------------------------------------------------*/
/* USER CODE BEGIN PD */

/* Note identifiers */
#define SILENCE 0x00
#define DO 0x01  /* C4 @ 523.251 Hz */
#define RE 0x02  /* D4 @ 587.330 Hz */
#define MI 0x04  /* E4 @ 659.255 Hz */
#define SOL 0x08 /* G4 @ 783.991 Hz */

/*
 * TIM2 ARR values for each note
 * Formula: ARR = TIM2_CLK / (PSC+1) / (32 × note_Hz) − 1
 *          TIM2_CLK = 90 MHz  (2 × PCLK1, PCLK1=45 MHz, APB1=/4)
 *          PSC = 99  →  tick clock = 90e6/100 = 900 kHz
 *
 *  Note   Target Hz   ARR = 900000/(32×f)−1   Actual Hz     Error
 *  C4     523.251      53.76 → 53              524.71 Hz     +1.4 Hz
 *  D4     587.330      47.85 → 47              586.96 Hz     −0.4 Hz
 *  E4     659.255      42.62 → 42              659.34 Hz     +0.1 Hz
 *  G4     783.991      35.82 → 35              781.25 Hz     −2.8 Hz
 *
 * Accuracy is sufficient for audible piano keys.
 * Fine-tune by adjusting ARR ±1 if needed.
 */
#define ARR_DO 53U  /* C4 */
#define ARR_RE 47U  /* D4 */
#define ARR_MI 42U  /* E4 */
#define ARR_SOL 35U /* G4 */

/* DAC GPIO: PB0(LSB=D0), PB4(D1), PB5(D2), PB6(MSB=D3)
 * PB3 is SYS_JTDO-SWO on Nucleo-F446RE → use PB0 (Arduino A3) for D0 */
#define DAC_MASK (GPIO_PIN_0 | GPIO_PIN_4 | GPIO_PIN_5 | GPIO_PIN_6)

/* Piano key GPIO (active HIGH, external 10kΩ pull-down) */
#define KEY_C_PIN GPIO_PIN_6  /* PC6  */
#define KEY_D_PIN GPIO_PIN_8  /* PC8  */
#define KEY_E_PIN GPIO_PIN_9  /* PC9  */
#define KEY_G_PIN GPIO_PIN_10 /* PC10 */

/* USER CODE END PD */

/* Private macro -------------------------------------------------------------*/
/* USER CODE BEGIN PM */

/* USER CODE END PM */

/* Private variables ---------------------------------------------------------*/
TIM_HandleTypeDef htim2;

UART_HandleTypeDef huart2;

/* USER CODE BEGIN PV */

/* 32-point sine wave, 4-bit amplitude (0–15) — identical to bare-metal */
static const uint8_t sin_wave32[32] = {
    8, 9, 11, 12, 13, 14, 14, 15, 15, 15, 14, 14, 13, 12, 11, 9,
    8, 7, 5,  4,  3,  2,  2,  1,  1,  1,  2,  2,  3,  4,  5,  7};

volatile uint32_t soundOff = 1; /* 1 = silent, 0 = playing             */
volatile uint32_t stateDAC = 0; /* current index into sin_wave32 (0–31) */

/* USER CODE END PV */

/* Private function prototypes -----------------------------------------------*/
void SystemClock_Config(void);
static void MX_GPIO_Init(void);
static void MX_USART2_UART_Init(void);
static void MX_TIM2_Init(void);
/* USER CODE BEGIN PFP */

/* USER CODE END PFP */

/* Private user code ---------------------------------------------------------*/
/* USER CODE BEGIN 0 */

/* DAC_Out_HAL: write 4-bit sine value to DAC GPIO pins
 * bit0 (LSB) → PB0   bit1 → PB4   bit2 → PB5   bit3 (MSB) → PB6
 * Pins are non-consecutive, so each bit is mapped individually. */
static void DAC_Out_HAL(uint8_t data) {
  uint32_t odr = GPIOB->ODR & ~DAC_MASK; /* clear all 4 DAC pins */
  if (data & 0x01U)
    odr |= GPIO_PIN_0; /* bit0 (LSB) → PB0     */
  if (data & 0x02U)
    odr |= GPIO_PIN_4; /* bit1       → PB4     */
  if (data & 0x04U)
    odr |= GPIO_PIN_5; /* bit2       → PB5     */
  if (data & 0x08U)
    odr |= GPIO_PIN_6; /* bit3 (MSB) → PB6     */
  GPIOB->ODR = odr;
}

/* Sound_Tone_HAL: set TIM2 reload to play a note
 * htim2 is the handle generated by CubeIDE */
static void Sound_Tone_HAL(TIM_HandleTypeDef *htim2, uint32_t arr) {
  HAL_TIM_Base_Stop_IT(htim2);
  soundOff = 0;
  stateDAC = 0;
  __HAL_TIM_SET_AUTORELOAD(htim2, arr);
  __HAL_TIM_SET_COUNTER(htim2, 0);
  HAL_TIM_Base_Start_IT(htim2);
}

/* Sound_Off_HAL: silence the DAC */
static void Sound_Off_HAL(TIM_HandleTypeDef *htim2) {
  soundOff = 1;
  DAC_Out_HAL(0);
  /* leave timer running at last ARR — ISR will output 0 while soundOff=1 */
  (void)htim2;
}

/* Piano_In_HAL: read 4 keys, return note identifier
 * Priority: G > E > D > C (same as bare-metal) */
static uint8_t Piano_In_HAL(void) {
  if (HAL_GPIO_ReadPin(GPIOC, KEY_G_PIN) == GPIO_PIN_SET)
    return SOL;
  if (HAL_GPIO_ReadPin(GPIOC, KEY_E_PIN) == GPIO_PIN_SET)
    return MI;
  if (HAL_GPIO_ReadPin(GPIOC, KEY_D_PIN) == GPIO_PIN_SET)
    return RE;
  if (HAL_GPIO_ReadPin(GPIOC, KEY_C_PIN) == GPIO_PIN_SET)
    return DO;
  return SILENCE;
}

/* uart_note_print: send note name + ideal vs actual Hz to USART2 virtual COM
 *
 * Actual Hz formula:  900000 / (ARR+1) / 32
 *   DO  ARR=53: 900000/54/32  = 520.83 Hz  (ideal 523.25, err -2.42 Hz)
 *   RE  ARR=47: 900000/48/32  = 585.94 Hz  (ideal 587.33, err -1.39 Hz)
 *   MI  ARR=42: 900000/43/32  = 654.07 Hz  (ideal 659.26, err -5.19 Hz)
 *   SOL ARR=35: 900000/36/32  = 781.25 Hz  (ideal 783.99, err -2.74 Hz)
 */
static void uart_note_print(uint8_t key) {
  const char *msg;
  switch (key) {
  case DO:
    msg = "[DO ] ideal=523.25 Hz  actual=520.83 Hz  err= -2.42 Hz\r\n";
    break;
  case RE:
    msg = "[RE ] ideal=587.33 Hz  actual=585.94 Hz  err= -1.39 Hz\r\n";
    break;
  case MI:
    msg = "[MI ] ideal=659.26 Hz  actual=654.07 Hz  err= -5.19 Hz\r\n";
    break;
  case SOL:
    msg = "[SOL] ideal=783.99 Hz  actual=781.25 Hz  err= -2.74 Hz\r\n";
    break;
  default:
    msg = "[---] silent\r\n";
    break;
  }
  for (const char *p = msg; *p; p++)
    HAL_UART_Transmit(&huart2, (const uint8_t *)p, 1, 10);
}

/* USER CODE END 0 */

/**
 * @brief  The application entry point.
 * @retval int
 */
int main(void) {

  /* USER CODE BEGIN 1 */

  /* USER CODE END 1 */

  /* MCU Configuration--------------------------------------------------------*/

  /* Reset of all peripherals, Initializes the Flash interface and the Systick.
   */
  HAL_Init();

  /* USER CODE BEGIN Init */

  /* USER CODE END Init */

  /* Configure the system clock */
  SystemClock_Config();

  /* USER CODE BEGIN SysInit */

  /* USER CODE END SysInit */

  /* Initialize all configured peripherals */
  MX_GPIO_Init();
  MX_USART2_UART_Init();
  MX_TIM2_Init();
  /* USER CODE BEGIN 2 */

  HAL_TIM_Base_Start_IT(&htim2); /* start TIM2 interrupt — tone set by loop */

  /* Startup banner + frequency comparison table (115200 baud) */
  const char *banner =
      "\r\n=== Lab 13 DAC Piano (STM32F446RE) ===\r\n"
      "TIM2: CLK=90MHz  PSC=99  tick=900kHz  32 sine samples\r\n"
      "Actual Hz = 900000 / (ARR+1) / 32\r\n"
      "\r\n"
      "  Key   Ideal Hz   ARR   Actual Hz   Error\r\n"
      "  DO    523.25     53    520.83      -2.42 Hz\r\n"
      "  RE    587.33     47    585.94      -1.39 Hz\r\n"
      "  MI    659.26     42    654.07      -5.19 Hz\r\n"
      "  SOL   783.99     35    781.25      -2.74 Hz\r\n"
      "\r\n"
      "Press a piano key:\r\n"
      "-------------------------------------------\r\n";
  for (const char *p = banner; *p; p++)
    HAL_UART_Transmit(&huart2, (const uint8_t *)p, 1, 10);

  /* USER CODE END 2 */

  /* Infinite loop */
  /* USER CODE BEGIN WHILE */
  uint8_t last_key = 0xFF; /* impossible value — forces first update */

  while (1) {
    uint8_t key = Piano_In_HAL();

    if (key != last_key) { /* only act when key state CHANGES */
      last_key = key;
      switch (key) {
      case DO:
        Sound_Tone_HAL(&htim2, ARR_DO);
        break;
      case RE:
        Sound_Tone_HAL(&htim2, ARR_RE);
        break;
      case MI:
        Sound_Tone_HAL(&htim2, ARR_MI);
        break;
      case SOL:
        Sound_Tone_HAL(&htim2, ARR_SOL);
        break;
      default:
        Sound_Off_HAL(&htim2);
        break;
      }

      uart_note_print(key); /* print note + Hz to serial terminal */

      /* LD2 solid ON while any key held, OFF when released */
      HAL_GPIO_WritePin(LD2_GPIO_Port, LD2_Pin,
                        (key != SILENCE) ? GPIO_PIN_SET : GPIO_PIN_RESET);
    }
    /* USER CODE END WHILE */

    /* USER CODE BEGIN 3 */
  }
  /* USER CODE END 3 */
}

/**
 * @brief System Clock Configuration
 * @retval None
 */
void SystemClock_Config(void) {
  RCC_OscInitTypeDef RCC_OscInitStruct = {0};
  RCC_ClkInitTypeDef RCC_ClkInitStruct = {0};

  /** Configure the main internal regulator output voltage
   */
  __HAL_RCC_PWR_CLK_ENABLE();
  __HAL_PWR_VOLTAGESCALING_CONFIG(PWR_REGULATOR_VOLTAGE_SCALE1);

  /** Initializes the RCC Oscillators according to the specified parameters
   * in the RCC_OscInitTypeDef structure.
   */
  RCC_OscInitStruct.OscillatorType = RCC_OSCILLATORTYPE_HSI;
  RCC_OscInitStruct.HSIState = RCC_HSI_ON;
  RCC_OscInitStruct.HSICalibrationValue = RCC_HSICALIBRATION_DEFAULT;
  RCC_OscInitStruct.PLL.PLLState = RCC_PLL_ON;
  RCC_OscInitStruct.PLL.PLLSource = RCC_PLLSOURCE_HSI;
  RCC_OscInitStruct.PLL.PLLM = 8;
  RCC_OscInitStruct.PLL.PLLN = 180;
  RCC_OscInitStruct.PLL.PLLP = RCC_PLLP_DIV2;
  RCC_OscInitStruct.PLL.PLLQ = 2;
  RCC_OscInitStruct.PLL.PLLR = 2;
  if (HAL_RCC_OscConfig(&RCC_OscInitStruct) != HAL_OK) {
    Error_Handler();
  }

  /** Activate the Over-Drive mode
   */
  if (HAL_PWREx_EnableOverDrive() != HAL_OK) {
    Error_Handler();
  }

  /** Initializes the CPU, AHB and APB buses clocks
   */
  RCC_ClkInitStruct.ClockType = RCC_CLOCKTYPE_HCLK | RCC_CLOCKTYPE_SYSCLK |
                                RCC_CLOCKTYPE_PCLK1 | RCC_CLOCKTYPE_PCLK2;
  RCC_ClkInitStruct.SYSCLKSource = RCC_SYSCLKSOURCE_PLLCLK;
  RCC_ClkInitStruct.AHBCLKDivider = RCC_SYSCLK_DIV1;
  RCC_ClkInitStruct.APB1CLKDivider = RCC_HCLK_DIV4;
  RCC_ClkInitStruct.APB2CLKDivider = RCC_HCLK_DIV2;

  if (HAL_RCC_ClockConfig(&RCC_ClkInitStruct, FLASH_LATENCY_5) != HAL_OK) {
    Error_Handler();
  }
}

/**
 * @brief TIM2 Initialization Function
 * @param None
 * @retval None
 */
static void MX_TIM2_Init(void) {

  /* USER CODE BEGIN TIM2_Init 0 */

  /* USER CODE END TIM2_Init 0 */

  TIM_ClockConfigTypeDef sClockSourceConfig = {0};
  TIM_MasterConfigTypeDef sMasterConfig = {0};

  /* USER CODE BEGIN TIM2_Init 1 */

  /* USER CODE END TIM2_Init 1 */
  htim2.Instance = TIM2;
  htim2.Init.Prescaler = 99;
  htim2.Init.CounterMode = TIM_COUNTERMODE_UP;
  htim2.Init.Period = 1022;
  htim2.Init.ClockDivision = TIM_CLOCKDIVISION_DIV1;
  htim2.Init.AutoReloadPreload = TIM_AUTORELOAD_PRELOAD_DISABLE;
  if (HAL_TIM_Base_Init(&htim2) != HAL_OK) {
    Error_Handler();
  }
  sClockSourceConfig.ClockSource = TIM_CLOCKSOURCE_INTERNAL;
  if (HAL_TIM_ConfigClockSource(&htim2, &sClockSourceConfig) != HAL_OK) {
    Error_Handler();
  }
  sMasterConfig.MasterOutputTrigger = TIM_TRGO_RESET;
  sMasterConfig.MasterSlaveMode = TIM_MASTERSLAVEMODE_DISABLE;
  if (HAL_TIMEx_MasterConfigSynchronization(&htim2, &sMasterConfig) != HAL_OK) {
    Error_Handler();
  }
  /* USER CODE BEGIN TIM2_Init 2 */

  /* USER CODE END TIM2_Init 2 */
}

/**
 * @brief USART2 Initialization Function
 * @param None
 * @retval None
 */
static void MX_USART2_UART_Init(void) {

  /* USER CODE BEGIN USART2_Init 0 */

  /* USER CODE END USART2_Init 0 */

  /* USER CODE BEGIN USART2_Init 1 */

  /* USER CODE END USART2_Init 1 */
  huart2.Instance = USART2;
  huart2.Init.BaudRate = 115200;
  huart2.Init.WordLength = UART_WORDLENGTH_8B;
  huart2.Init.StopBits = UART_STOPBITS_1;
  huart2.Init.Parity = UART_PARITY_NONE;
  huart2.Init.Mode = UART_MODE_TX_RX;
  huart2.Init.HwFlowCtl = UART_HWCONTROL_NONE;
  huart2.Init.OverSampling = UART_OVERSAMPLING_16;
  if (HAL_UART_Init(&huart2) != HAL_OK) {
    Error_Handler();
  }
  /* USER CODE BEGIN USART2_Init 2 */

  /* USER CODE END USART2_Init 2 */
}

/**
 * @brief GPIO Initialization Function
 * @param None
 * @retval None
 */
static void MX_GPIO_Init(void) {
  GPIO_InitTypeDef GPIO_InitStruct = {0};
  /* USER CODE BEGIN MX_GPIO_Init_1 */

  /* USER CODE END MX_GPIO_Init_1 */

  /* GPIO Ports Clock Enable */
  __HAL_RCC_GPIOC_CLK_ENABLE();
  __HAL_RCC_GPIOH_CLK_ENABLE();
  __HAL_RCC_GPIOA_CLK_ENABLE();
  __HAL_RCC_GPIOB_CLK_ENABLE();

  /*Configure GPIO pin Output Level */
  HAL_GPIO_WritePin(LD2_GPIO_Port, LD2_Pin, GPIO_PIN_RESET);

  /*Configure GPIO pin Output Level */
  HAL_GPIO_WritePin(GPIOB, DAC0_Pin | DAC1_Pin | DAC2_Pin | DAC3_Pin,
                    GPIO_PIN_RESET);

  /*Configure GPIO pin : B1_Pin */
  GPIO_InitStruct.Pin = B1_Pin;
  GPIO_InitStruct.Mode = GPIO_MODE_IT_FALLING;
  GPIO_InitStruct.Pull = GPIO_NOPULL;
  HAL_GPIO_Init(B1_GPIO_Port, &GPIO_InitStruct);

  /*Configure GPIO pin : LD2_Pin */
  GPIO_InitStruct.Pin = LD2_Pin;
  GPIO_InitStruct.Mode = GPIO_MODE_OUTPUT_PP;
  GPIO_InitStruct.Pull = GPIO_NOPULL;
  GPIO_InitStruct.Speed = GPIO_SPEED_FREQ_LOW;
  HAL_GPIO_Init(LD2_GPIO_Port, &GPIO_InitStruct);

  /*Configure GPIO pins : DAC0_Pin DAC1_Pin DAC2_Pin DAC3_Pin */
  GPIO_InitStruct.Pin = DAC0_Pin | DAC1_Pin | DAC2_Pin | DAC3_Pin;
  GPIO_InitStruct.Mode = GPIO_MODE_OUTPUT_PP;
  GPIO_InitStruct.Pull = GPIO_NOPULL;
  GPIO_InitStruct.Speed = GPIO_SPEED_FREQ_LOW;
  HAL_GPIO_Init(GPIOB, &GPIO_InitStruct);

  /*Configure GPIO pins : KEY_C_Pin KEY_D_Pin KEY_E_Pin KEY_G_Pin */
  GPIO_InitStruct.Pin = KEY_C_Pin | KEY_D_Pin | KEY_E_Pin | KEY_G_Pin;
  GPIO_InitStruct.Mode = GPIO_MODE_INPUT;
  GPIO_InitStruct.Pull = GPIO_NOPULL;
  HAL_GPIO_Init(GPIOC, &GPIO_InitStruct);

  /* USER CODE BEGIN MX_GPIO_Init_2 */

  /* USER CODE END MX_GPIO_Init_2 */
}

/* USER CODE BEGIN 4 */

/* HAL_TIM_PeriodElapsedCallback — fires at (TIM2_CLK / (PSC+1) / (ARR+1)) Hz
 * Each call advances the 32-point sine table and writes to the R-2R DAC.
 * Note frequency = ISR rate / 32 samples. */
void HAL_TIM_PeriodElapsedCallback(TIM_HandleTypeDef *htim) {
  if (htim->Instance != TIM2)
    return; /* guard: ignore other timer callbacks */

  /* DEBUG: toggle LD2 at TIM2 rate — visible as dim flicker if ISR is firing */
  /* Remove this line once sound is confirmed working */
  // HAL_GPIO_TogglePin(LD2_GPIO_Port, LD2_Pin);

  if (soundOff) {
    DAC_Out_HAL(0); /* silence: output 0 V         */
  } else {
    stateDAC = (stateDAC + 1) & 0x1FU; /* advance index, wrap at 32   */
    DAC_Out_HAL(sin_wave32[stateDAC]); /* write sample to R-2R DAC    */
  }
}

/* USER CODE END 4 */

/**
 * @brief  This function is executed in case of error occurrence.
 * @retval None
 */
void Error_Handler(void) {
  /* USER CODE BEGIN Error_Handler_Debug */
  /* User can add his own implementation to report the HAL error return state */
  __disable_irq();
  while (1) {
  }
  /* USER CODE END Error_Handler_Debug */
}
#ifdef USE_FULL_ASSERT
/**
 * @brief  Reports the name of the source file and the source line number
 *         where the assert_param error has occurred.
 * @param  file: pointer to the source file name
 * @param  line: assert_param error line source number
 * @retval None
 */
void assert_failed(uint8_t *file, uint32_t line) {
  /* USER CODE BEGIN 6 */
  /* User can add his own implementation to report the file name and line
     number, ex: printf("Wrong parameters value: file %s on line %d\r\n", file,
     line) */
  /* USER CODE END 6 */
}
#endif /* USE_FULL_ASSERT */
