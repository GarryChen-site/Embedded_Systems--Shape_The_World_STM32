

#include "ssd1306.h"
#include "i2c.h"
#include <stdint.h>

#define SSD1306_ADDR 0x3CU
#define SSD1306_CMD 0x00U
#define SSD1306_DATA 0x40U

// =========================================================================
// 5×8 pixel ASCII font, column-major, LSB at top.
// Index 0 = ASCII 0x20 (space), index 95 = ASCII 0x7F (DEL / unused).
// Each entry: 5 bytes, one per column, bit 0 = topmost pixel.
// =========================================================================
static const uint8_t font5x8[96][5] = {
    {0x00, 0x00, 0x00, 0x00, 0x00}, /* 0x20  ' ' */
    {0x00, 0x00, 0x5F, 0x00, 0x00}, /* 0x21  '!' */
    {0x00, 0x07, 0x00, 0x07, 0x00}, /* 0x22  '"' */
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    {0x00, 0x00, 0x00, 0x00, 0x00}, /* 0x7F  DEL (unused) */
};

static uint8_t fb[1024];

static void ssd1306_cmd(uint8_t cmd) {
  uint8_t buf[2] = {SSD1306_CMD, cmd};
  I2C1_Send(SSD1306_ADDR, buf, 2);
}

static void ssd1306_cmd2(uint8_t cmd, uint8_t arg) {
  uint8_t buf[3] = {SSD1306_CMD, cmd, arg};
  I2C1_Send(SSD1306_ADDR, buf, 3);
}

static void ssd1306_cmd3(uint8_t cmd, uint8_t a0, uint8_t a1) {
  uint8_t buf[4] = {SSD1306_CMD, cmd, a0, a1};
  I2C1_Send(SSD1306_ADDR, buf, 4);
}

void SSD1306_Init(void) {
  ssd1306_cmd(0xAE);        // Display OFF (sleep mode)
  ssd1306_cmd2(0xD5, 0x80); // Set display clock: divide=1, freq=8 (reset)
  ssd1306_cmd2(0xA8, 0x3F); // Multiplex ratio: 64 rows (0x3F = 63)
  ssd1306_cmd2(0xD3, 0x00); // Display offset: 0
  ssd1306_cmd(0x40);        // Display start line: line 0
  ssd1306_cmd2(0x8D, 0x14); // Charge pump: ENABLE (internal, 0x14)
  ssd1306_cmd2(0x20, 0x00); // Memory addressing mode: HORIZONTAL
  ssd1306_cmd(0xA1);        // Segment re-map: col 127 → SEG0 (normal)
  ssd1306_cmd(0xC8);        // COM scan direction: remapped (COM[N-1]→COM0)
  ssd1306_cmd2(0xDA, 0x12); // COM pins config: alternative (for 128×64)
  ssd1306_cmd2(0x81, 0xCF); // Contrast: 0xCF (bright)
  ssd1306_cmd2(0xD9, 0xF1); // Pre-charge period: phase1=1, phase2=15
  ssd1306_cmd2(0xDB, 0x40); // VCOMH deselect level: 0x40
  ssd1306_cmd(0xA4);        // Entire display ON: output follows GDDRAM
  ssd1306_cmd(0xA6);        // Normal display (0xA7 = inverted)
  ssd1306_cmd(0x2E);        // Deactivate scroll
  SSD1306_Clear();
  SSD1306_Update();  // clear display before turning on
  ssd1306_cmd(0xAF); // Display ON
}

void SSD1306_Clear(void) {
  for (uint32_t i = 0; i < 1024U; i++) {
    fb[i] = 0x00U;
  }
}

void SSD1306_DrawString(uint8_t col, uint8_t page, const char *s) {
  while (*s) {
    uint8_t c = (uint8_t)*s++;
    // Clamp to printable range
    if (c < 0x20U || c > 0x7FU) {
      c = 0x20U;
    }
    const uint8_t *glyph = font5x8[c - 0x20U];
    uint32_t base = (uint32_t)page * 128U + col;
    for (uint8_t i = 0; i < 5U; i++) {
      if (col + i >= 128U) {
        break;
      }
      fb[base + i] = glyph[i];
    }
    if (col + 5U < 128U) {
      fb[base + 5U] = 0x00U;
    }
    col += 6U;
    if (col >= 128U) {
      break;
    }
  }
}

void SSD1306_DrawHLine(uint8_t page) {
  uint32_t base = (uint32_t)page * 128U;
  for (uint8_t i = 0; i < 128U; i++)
    fb[base + i] = 0x01U; // bit 0 = topmost pixel of page
}

void SSD1306_DrawBar(uint8_t page, uint8_t percent) {
  if (percent > 100U) {
    percent = 100U;
  }
  uint32_t base = (uint32_t)page * 128U;
  uint8_t fill = (uint8_t)((uint32_t)percent * 126U / 100U);

  fb[base + 0] = 0xFFU;
  fb[base + 127] = 0xFFU;
  for (uint8_t i = 1U; i <= 126U; i++) {
    fb[base + i] = (i <= fill) ? 0x7EU : 0x42U;
  }
}

void SSD1306_Update(void) {
  ssd1306_cmd3(0x21, 0x00, 0x7F); // column address: 0 to 127
  ssd1306_cmd3(0x22, 0x00, 0x07); // page address:   0 to 7
  I2C1_SendFrag(SSD1306_ADDR, SSD1306_DATA, fb, 1024U);
}
