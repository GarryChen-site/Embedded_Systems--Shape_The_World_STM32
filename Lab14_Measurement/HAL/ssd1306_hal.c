// ssd1306_hal.c — Lab 14 Measurement, STM32 F446RE (HAL version)
//
// SSD1306 OLED driver — HAL port of ssd1306.c.
//
// KEY DIFFERENCES FROM BARE-METAL ssd1306.c:
//   - No i2c.h dependency.  Uses HAL_I2C_Master_Transmit(&hi2c1, ...) instead.
//   - DevAddress = SSD1306_ADDR << 1 = 0x78 ("Target device address: The device
//     7 bits address value in datasheet must be shifted to the left before
//     calling the interface").
//   - SSD1306_Update uses a static 1025-byte tx_buf to combine the 0x40
//     control byte with the framebuffer in one call (avoids double-STOP).
//   - All other logic (framebuffer, font, draw primitives) is identical.
//
// FONT: standard 5x8 pixel ASCII, column-major, LSB=top.
//   96 characters: 0x20 (space) through 0x7F (DEL).

#include "ssd1306_hal.h"
#include "stm32f4xx_hal.h" /* HAL types — generated by CubeIDE        */

// =========================================================================
// SSD1306 I2C constants (SSD1306 datasheet §8.1.5)
// =========================================================================
// HAL expects 8-bit address (7-bit << 1).  SA0=GND → 0x3C → 8-bit 0x78.
#define SSD1306_I2C_ADDR ((uint16_t)(0x3CU << 1)) // 0x78
#define SSD1306_CMD 0x00U  // control byte: command stream
#define SSD1306_DATA 0x40U // control byte: GDDRAM data stream

extern I2C_HandleTypeDef hi2c1;

// =========================================================================
// 5×8 pixel ASCII font — identical to bare-metal ssd1306.c
// =========================================================================
static const uint8_t font5x8[96][5] = {
    {0x00, 0x00, 0x00, 0x00, 0x00}, /* 0x20  ' ' */
    {0x00, 0x00, 0x5F, 0x00, 0x00}, /* 0x21  '!' */
    {0x00, 0x07, 0x00, 0x07, 0x00}, /* 0x22  '"' */
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    {0x00, 0x00, 0x00, 0x00, 0x00}, /* 0x7F  DEL */
};

// =========================================================================
// 1024-byte RAM framebuffer + 1025-byte TX buffer for SSD1306_Update
// fb[page*128 + col]: bit 0 = top pixel of page, bit 7 = bottom.
// tx_buf[0] = 0x40 (DATA control byte); tx_buf[1..1024] = fb copy.
// =========================================================================
static uint8_t fb[1024];
static uint8_t tx_buf[1025]; // static: avoids 1 kB stack frame

// =========================================================================
// Internal helpers — send commands via HAL_I2C_Master_Transmit
// =========================================================================
static void ssd1306_cmd(uint8_t cmd) {
  uint8_t buf[2] = {SSD1306_CMD, cmd};
  HAL_I2C_Master_Transmit(&hi2c1, SSD1306_I2C_ADDR, buf, 2, 10);
}
static void ssd1306_cmd2(uint8_t cmd, uint8_t arg) {
  uint8_t buf[3] = {SSD1306_CMD, cmd, arg};
  HAL_I2C_Master_Transmit(&hi2c1, SSD1306_I2C_ADDR, buf, 3, 10);
}
static void ssd1306_cmd3(uint8_t cmd, uint8_t a0, uint8_t a1) {
  uint8_t buf[4] = {SSD1306_CMD, cmd, a0, a1};
  HAL_I2C_Master_Transmit(&hi2c1, SSD1306_I2C_ADDR, buf, 4, 10);
}

// =========================================================================
// SSD1306_Init  (SSD1306 Application Note §2 power-on sequence)
// =========================================================================
void SSD1306_Init(void) {
  HAL_Delay(10);            // wait for OLED VCC to settle
  ssd1306_cmd(0xAE);        // display OFF
  ssd1306_cmd2(0xD5, 0x80); // clock / oscillator freq
  ssd1306_cmd2(0xA8, 0x3F); // multiplex ratio: 64 rows
  ssd1306_cmd2(0xD3, 0x00); // display offset: 0
  ssd1306_cmd(0x40);        // start line: 0
  ssd1306_cmd2(0x8D, 0x14); // charge pump: ENABLE
  ssd1306_cmd2(0x20, 0x00); // memory addressing: HORIZONTAL
  ssd1306_cmd(0xA1);        // segment re-map (normal orientation)
  ssd1306_cmd(0xC8);        // COM scan remapped
  ssd1306_cmd2(0xDA, 0x12); // COM pins: alternative (128×64)
  ssd1306_cmd2(0x81, 0xCF); // contrast: 0xCF
  ssd1306_cmd2(0xD9, 0xF1); // pre-charge period
  ssd1306_cmd2(0xDB, 0x40); // VCOMH deselect level
  ssd1306_cmd(0xA4);        // resume from GDDRAM
  ssd1306_cmd(0xA6);        // normal display (not inverted)
  ssd1306_cmd(0x2E);        // deactivate scroll
  SSD1306_Clear();
  SSD1306_Update();  // clear display before turning on
  ssd1306_cmd(0xAF); // display ON
}

// =========================================================================
// SSD1306_Clear
// =========================================================================
void SSD1306_Clear(void) {
  for (uint32_t i = 0; i < 1024U; i++)
    fb[i] = 0x00U;
}

// =========================================================================
// SSD1306_DrawString
// =========================================================================
void SSD1306_DrawString(uint8_t col, uint8_t page, const char *s) {
  while (*s) {
    uint8_t c = (uint8_t)*s++;
    if (c < 0x20U || c > 0x7FU)
      c = 0x20U;
    const uint8_t *g = font5x8[c - 0x20U];
    uint32_t base = (uint32_t)page * 128U + col;
    for (uint8_t i = 0; i < 5U; i++) {
      if (col + i >= 128U)
        break;
      fb[base + i] = g[i];
    }
    if (col + 5U < 128U)
      fb[base + 5U] = 0x00U;
    col += 6U;
    if (col >= 128U)
      break;
  }
}

// =========================================================================
// SSD1306_DrawHLine
// =========================================================================
void SSD1306_DrawHLine(uint8_t page) {
  uint32_t base = (uint32_t)page * 128U;
  for (uint8_t i = 0; i < 128U; i++)
    fb[base + i] = 0x01U;
}

// =========================================================================
// SSD1306_DrawBar
// =========================================================================
void SSD1306_DrawBar(uint8_t page, uint8_t percent) {
  if (percent > 100U)
    percent = 100U;
  uint32_t base = (uint32_t)page * 128U;
  uint8_t fill = (uint8_t)((uint32_t)percent * 126U / 100U);
  fb[base + 0] = 0xFFU;
  fb[base + 127] = 0xFFU;
  for (uint8_t i = 1U; i <= 126U; i++)
    fb[base + i] = (i <= fill) ? 0x7EU : 0x42U;
}

// =========================================================================
// SSD1306_Update — flush framebuffer to GDDRAM in one I2C transaction
// =========================================================================
void SSD1306_Update(void) {
  ssd1306_cmd3(0x21, 0x00, 0x7F); // column address: 0 – 127
  ssd1306_cmd3(0x22, 0x00, 0x07); // page address:   0 – 7
  // Prepend 0x40 DATA control byte to framebuffer
  tx_buf[0] = SSD1306_DATA;
  for (uint32_t i = 0; i < 1024U; i++)
    tx_buf[i + 1U] = fb[i];
  HAL_I2C_Master_Transmit(&hi2c1, SSD1306_I2C_ADDR, tx_buf, 1025U, 100U);
}
