// SpaceInvaders.c — Lab 15 Space Invaders, HAL version
//
// Adapted from SpaceInvaders_stm32.c (bare-metal STM32 port).
// Hardware-specific sections removed; replaced by HAL driver calls.
//
// =========================================================================
// HARDWARE WIRING (for reference — configured in CubeIDE IOC / gen.c)
// =========================================================================
//
//  DISPLAY (SSD1306 I2C OLED 128×64):
//    PB6 (SCL)  CN10 pin 17  (Arduino D10)  ↔  SSD1306 SCL
//    PB7 (SDA)  CN10 pin 19               ↔  SSD1306 SDA
//    3.3V        CN8 pin 4                →   SSD1306 VCC
//    GND                                  →   SSD1306 GND
//
//  TRIMMING POTENTIOMETER (player ship position):
//    PA0  (CN8 pin 1 "A0")  ←  wiper
//    GND                    ←  CCW end (pin 1)
//    3.3V (CN8 pin 4)       ←  CW  end (pin 3)
//    Electrical range: 0°–240° → ADC 0–4095 → player X 0–110
//
//  FIRE BUTTONS (normally-open, with external pull-down to GND):
//    PC6  (CN10 pin 13)  ← missile button  (rising edge → EXTI6)
//    PC8  (CN10 pin 3)   ← laser  button   (rising edge → EXTI8)
//
//  SOUND DAC (R-2R ladder → buzzer optional):
//    PB0  (CN8  pin 5  / Arduino A3) ← bit 0 (LSB)
//    PB1  (CN10 pin 24)              ← bit 1
//    PB2  (CN10 pin 22)              ← bit 2
//    PB4  (CN10 pin 27 / Arduino D12)← bit 3 (MSB)  [PB3 is SWO, reserved]
//
// =========================================================================
// WHAT WAS REMOVED FROM THE BARE-METAL VERSION (see SpaceInvaders_stm32.c)
// =========================================================================
//  • All peripheral register #define macros (RCC_*, GPIO*, ADC1_*, EXTI_*, ...)
//  • ADC0_Init(), ADC0_In()         — replaced by HAL ADC in main.c / gen.c
//  • SysTick_Init_30Hz()            — HAL SysTick (1 kHz) used instead
//  • Switch_Init()                  — configured by CubeIDE EXTI in main.c
//  • Delay100ms(), Delay1ms()       — replaced by HAL_Delay()
//  • SysTick_Handler()              — ADC polled by HAL_GetTick() in main.c
//  • EXTI9_5_IRQHandler()           — HAL_GPIO_EXTI_Callback() in main.c
//  • main()                         — in CubeIDE-generated main.c / gen.c
//  • STyp typedef                   — moved to game_types.h

#include <stdint.h>
#include "stm32f4xx_hal.h"   /* HAL_Delay */
#include "ssd1306_hal.h"
#include "dac_hal.h"
#include "sound_hal.h"
#include "game_types.h"      /* STyp struct */
#include "random.h"

// =========================================================================
// Game global variables
// (ADCdata/playerPosition/playerFlag/laserFlag/missileFlag declared volatile;
//  main.c declares them extern to share with HAL_GPIO_EXTI_Callback)
// =========================================================================
volatile uint32_t ADCdata        = 0;
volatile uint32_t playerPosition = 0;   // 0-110 (SCREENW - PLAYERW)
volatile uint32_t playerFlag     = 0;
volatile uint32_t laserFlag      = 0;
volatile uint32_t missileFlag    = 0;
         uint32_t FrameCount     = 0;   // 0,1,0,1,… for 2-frame animation
         uint32_t randomnum      = 0;
         uint32_t currentLevel   = 1;
         uint32_t numEnemies     = 8;
         uint32_t playMissile    = 8;   // index into Missile[] for player
         uint32_t playLaser      = 8;   // index into Laser[]   for player
         int32_t  enemyDir       = 1;
         uint32_t enemyDrop      = 0;

// =========================================================================
// BMP image data — identical to original (hardware-independent raw bytes)
// 4-bit indexed BMP, LM3S format; decoded by SSD1306_PrintBMP()
// =========================================================================

// enemy ship — top row, arms/mouth closed   (16×10)
const uint8_t SmallEnemy30PointA[] = {
 0x42,0x4D,0xC6,0x00,0x00,0x00,0x00,0x00,0x00,0x00,0x76,0x00,0x00,0x00,0x28,0x00,
 0x00,0x00,0x10,0x00,0x00,0x00,0x0A,0x00,0x00,0x00,0x01,0x00,0x04,0x00,0x00,0x00,
 0x00,0x00,0x50,0x00,0x00,0x00,0x00,0x00,0x00,0x00,0x00,0x00,0x00,0x00,0x00,0x00,
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 0x00,0x00,0x00,0x00,0x00,0x00,0xFF};

// enemy ship — top row, arms/mouth open     (16×10)
const uint8_t SmallEnemy30PointB[] = {
 0x42,0x4D,0xC6,0x00,0x00,0x00,0x00,0x00,0x00,0x00,0x76,0x00,0x00,0x00,0x28,0x00,
 0x00,0x00,0x10,0x00,0x00,0x00,0x0A,0x00,0x00,0x00,0x01,0x00,0x04,0x00,0x00,0x00,
 0x00,0x00,0x50,0x00,0x00,0x00,0x00,0x00,0x00,0x00,0x00,0x00,0x00,0x00,0x00,0x00,
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 0x00,0x00,0x00,0x00,0x00,0x00,0xFF};

// enemy ship — middle row, arms together    (16×10)
const uint8_t SmallEnemy20PointA[] = {
 0x42,0x4D,0xC6,0x00,0x00,0x00,0x00,0x00,0x00,0x00,0x76,0x00,0x00,0x00,0x28,0x00,
 0x00,0x00,0x10,0x00,0x00,0x00,0x0A,0x00,0x00,0x00,0x01,0x00,0x04,0x00,0x00,0x00,
 0x00,0x00,0x50,0x00,0x00,0x00,0x00,0x00,0x00,0x00,0x00,0x00,0x00,0x00,0x00,0x00,
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 0x00,0x00,0x00,0x00,0x00,0x00,0xFF};

// enemy ship — middle row, arms apart       (16×10)
const uint8_t SmallEnemy20PointB[] = {
 0x42,0x4D,0xC6,0x00,0x00,0x00,0x00,0x00,0x00,0x00,0x76,0x00,0x00,0x00,0x28,0x00,
 0x00,0x00,0x10,0x00,0x00,0x00,0x0A,0x00,0x00,0x00,0x01,0x00,0x04,0x00,0x00,0x00,
 0x00,0x00,0x50,0x00,0x00,0x00,0x00,0x00,0x00,0x00,0x00,0x00,0x00,0x00,0x00,0x00,
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 0x00,0x00,0x00,0x00,0x00,0x00,0xFF};

// enemy ship — bottom row, arms down        (16×10)
const uint8_t SmallEnemy10PointA[] = {
 0x42,0x4D,0xC6,0x00,0x00,0x00,0x00,0x00,0x00,0x00,0x76,0x00,0x00,0x00,0x28,0x00,
 0x00,0x00,0x10,0x00,0x00,0x00,0x0A,0x00,0x00,0x00,0x01,0x00,0x04,0x00,0x00,0x00,
 0x00,0x00,0x50,0x00,0x00,0x00,0x00,0x00,0x00,0x00,0x00,0x00,0x00,0x00,0x00,0x00,
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 0x00,0x00,0x00,0x00,0x00,0x00,0xFF};

// enemy ship — bottom row, arms up          (16×10)
const uint8_t SmallEnemy10PointB[] = {
 0x42,0x4D,0xC6,0x00,0x00,0x00,0x00,0x00,0x00,0x00,0x76,0x00,0x00,0x00,0x28,0x00,
 0x00,0x00,0x10,0x00,0x00,0x00,0x0A,0x00,0x00,0x00,0x01,0x00,0x04,0x00,0x00,0x00,
 0x00,0x00,0x50,0x00,0x00,0x00,0x00,0x00,0x00,0x00,0x00,0x00,0x00,0x00,0x00,0x00,
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 0x00,0x00,0x00,0x00,0x00,0x00,0xFF};

// player ship  (18×8, with 2 black erase columns each side)
const uint8_t PlayerShip0[] = {
 0x42,0x4D,0xD6,0x00,0x00,0x00,0x00,0x00,0x00,0x00,0x76,0x00,0x00,0x00,0x28,0x00,
 0x00,0x00,0x12,0x00,0x00,0x00,0x08,0x00,0x00,0x00,0x01,0x00,0x04,0x00,0x00,0x00,
 0x00,0x00,0x60,0x00,0x00,0x00,0xC4,0x0E,0x00,0x00,0xC4,0x0E,0x00,0x00,0x00,0x00,
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 0x00,0x00,0x00,0x00,0x00,0x00,0xFF};

// bonus UFO  (20×7, with 2 black erase columns each side)
const uint8_t SmallEnemyBonus0[] = {
 0x42,0x4D,0xCA,0x00,0x00,0x00,0x00,0x00,0x00,0x00,0x76,0x00,0x00,0x00,0x28,0x00,
 0x00,0x00,0x14,0x00,0x00,0x00,0x07,0x00,0x00,0x00,0x01,0x00,0x04,0x00,0x00,0x00,
 0x00,0x00,0x54,0x00,0x00,0x00,0x00,0x00,0x00,0x00,0x00,0x00,0x00,0x00,0x00,0x00,
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 0x00,0x0F,0xFF,0xFF,0xF0,0x00,0x00,0x00,0x00,0x00,0xFF};

// bunker — undamaged  (18×5)
const uint8_t Bunker0[] = {
 0x42,0x4D,0xB2,0x00,0x00,0x00,0x00,0x00,0x00,0x00,0x76,0x00,0x00,0x00,0x28,0x00,
 0x00,0x00,0x12,0x00,0x00,0x00,0x05,0x00,0x00,0x00,0x01,0x00,0x04,0x00,0x00,0x00,
 0x00,0x00,0x3C,0x00,0x00,0x00,0xC4,0x0E,0x00,0x00,0xC4,0x0E,0x00,0x00,0x00,0x00,
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 0x00,0x00,0xFF};

// bunker — slight damage  (18×5)
const uint8_t Bunker1[] = {
 0x42,0x4D,0xB2,0x00,0x00,0x00,0x00,0x00,0x00,0x00,0x76,0x00,0x00,0x00,0x28,0x00,
 0x00,0x00,0x12,0x00,0x00,0x00,0x05,0x00,0x00,0x00,0x01,0x00,0x04,0x00,0x00,0x00,
 0x00,0x00,0x3C,0x00,0x00,0x00,0xC4,0x0E,0x00,0x00,0xC4,0x0E,0x00,0x00,0x00,0x00,
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 0x00,0x00,0xFF};

// bunker — heavy damage   (18×5)
const uint8_t Bunker2[] = {
 0x42,0x4D,0xB2,0x00,0x00,0x00,0x00,0x00,0x00,0x00,0x76,0x00,0x00,0x00,0x28,0x00,
 0x00,0x00,0x12,0x00,0x00,0x00,0x05,0x00,0x00,0x00,0x01,0x00,0x04,0x00,0x00,0x00,
 0x00,0x00,0x3C,0x00,0x00,0x00,0xC4,0x0E,0x00,0x00,0xC4,0x0E,0x00,0x00,0x00,0x00,
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 0x00,0x00,0xFF};

// bunker — destroyed (blank)  (18×5)
const uint8_t Bunker3[] = {
 0x42,0x4D,0xB2,0x00,0x00,0x00,0x00,0x00,0x00,0x00,0x76,0x00,0x00,0x00,0x28,0x00,
 0x00,0x00,0x12,0x00,0x00,0x00,0x05,0x00,0x00,0x00,0x01,0x00,0x04,0x00,0x00,0x00,
 0x00,0x00,0x3C,0x00,0x00,0x00,0xC4,0x0E,0x00,0x00,0xC4,0x0E,0x00,0x00,0x00,0x00,
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 0x00,0x00,0xFF};

// large explosion, frame 0  (18×8)
const uint8_t BigExplosion0[] = {
 0x42,0x4D,0xD6,0x00,0x00,0x00,0x00,0x00,0x00,0x00,0x76,0x00,0x00,0x00,0x28,0x00,
 0x00,0x00,0x12,0x00,0x00,0x00,0x08,0x00,0x00,0x00,0x01,0x00,0x04,0x00,0x00,0x00,
 0x00,0x00,0x60,0x00,0x00,0x00,0x00,0x00,0x00,0x00,0x00,0x00,0x00,0x00,0x00,0x00,
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 0x90,0x00,0x0A,0x00,0x00,0x00,0xFF};

// large explosion, frame 1  (18×8)
const uint8_t BigExplosion1[] = {
 0x42,0x4D,0xD6,0x00,0x00,0x00,0x00,0x00,0x00,0x00,0x76,0x00,0x00,0x00,0x28,0x00,
 0x00,0x00,0x12,0x00,0x00,0x00,0x08,0x00,0x00,0x00,0x01,0x00,0x04,0x00,0x00,0x00,
 0x00,0x00,0x60,0x00,0x00,0x00,0x00,0x00,0x00,0x00,0x00,0x00,0x00,0x00,0x00,0x00,
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 0xB0,0x00,0x09,0x00,0x00,0x00,0xFF};

// small explosion  (16×10)
const uint8_t SmallExplosion0[] = {
 0x42,0x4D,0xC6,0x00,0x00,0x00,0x00,0x00,0x00,0x00,0x76,0x00,0x00,0x00,0x28,0x00,
 0x00,0x00,0x10,0x00,0x00,0x00,0x0A,0x00,0x00,0x00,0x01,0x00,0x04,0x00,0x00,0x00,
 0x00,0x00,0x50,0x00,0x00,0x00,0x00,0x00,0x00,0x00,0x00,0x00,0x00,0x00,0x00,0x00,
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 0x00,0x00,0x00,0x00,0x00,0x00,0xFF};

// small explosion blank (erase)  (16×10)
const uint8_t SmallExplosion1[] = {
 0x42,0x4D,0xC6,0x00,0x00,0x00,0x00,0x00,0x00,0x00,0x76,0x00,0x00,0x00,0x28,0x00,
 0x00,0x00,0x10,0x00,0x00,0x00,0x0A,0x00,0x00,0x00,0x01,0x00,0x04,0x00,0x00,0x00,
 0x00,0x00,0x50,0x00,0x00,0x00,0x00,0x00,0x00,0x00,0x00,0x00,0x00,0x00,0x00,0x00,
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 0x00,0x00,0x00,0x00,0x00,0x00,0xFF};

// player missile in flight  (4×9)
const uint8_t Missile0[] = {
 0x42,0x4D,0x9A,0x00,0x00,0x00,0x00,0x00,0x00,0x00,0x76,0x00,0x00,0x00,0x28,0x00,
 0x00,0x00,0x04,0x00,0x00,0x00,0x09,0x00,0x00,0x00,0x01,0x00,0x04,0x00,0x00,0x00,
 0x00,0x00,0x24,0x00,0x00,0x00,0x00,0x00,0x00,0x00,0x00,0x00,0x00,0x00,0x00,0x00,
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 0x00,0x00,0x0F,0x00,0x00,0x00,0x00,0x00,0x00,0x00,0xFF};

// player missile alternate  (4×9)
const uint8_t Missile1[] = {
 0x42,0x4D,0x9A,0x00,0x00,0x00,0x00,0x00,0x00,0x00,0x76,0x00,0x00,0x00,0x28,0x00,
 0x00,0x00,0x04,0x00,0x00,0x00,0x09,0x00,0x00,0x00,0x01,0x00,0x04,0x00,0x00,0x00,
 0x00,0x00,0x24,0x00,0x00,0x00,0x00,0x00,0x00,0x00,0x00,0x00,0x00,0x00,0x00,0x00,
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 0x00,0x00,0x00,0xF0,0x00,0x00,0x00,0x00,0x00,0x00,0xFF};

// missile blank (erase)  (4×9)
const uint8_t Missile2[] = {
 0x42,0x4D,0x9A,0x00,0x00,0x00,0x00,0x00,0x00,0x00,0x76,0x00,0x00,0x00,0x28,0x00,
 0x00,0x00,0x04,0x00,0x00,0x00,0x09,0x00,0x00,0x00,0x01,0x00,0x04,0x00,0x00,0x00,
 0x00,0x00,0x24,0x00,0x00,0x00,0x00,0x00,0x00,0x00,0x00,0x00,0x00,0x00,0x00,0x00,
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 0x00,0x00,0x00,0x00,0x00,0x00,0x00,0x00,0x00,0x00,0xFF};

// laser burst  (2×9)
const uint8_t Laser0[] = {
 0x42,0x4D,0x9A,0x00,0x00,0x00,0x00,0x00,0x00,0x00,0x76,0x00,0x00,0x00,0x28,0x00,
 0x00,0x00,0x02,0x00,0x00,0x00,0x09,0x00,0x00,0x00,0x01,0x00,0x04,0x00,0x00,0x00,
 0x00,0x00,0x24,0x00,0x00,0x00,0x00,0x00,0x00,0x00,0x00,0x00,0x00,0x00,0x00,0x00,
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 0x00,0x00,0xFF,0x00,0x00,0x00,0x00,0x00,0x00,0x00,0xFF};

// laser blank (erase)  (2×9)
const uint8_t Laser1[] = {
 0x42,0x4D,0x9A,0x00,0x00,0x00,0x00,0x00,0x00,0x00,0x76,0x00,0x00,0x00,0x28,0x00,
 0x00,0x00,0x02,0x00,0x00,0x00,0x09,0x00,0x00,0x00,0x01,0x00,0x04,0x00,0x00,0x00,
 0x00,0x00,0x24,0x00,0x00,0x00,0x00,0x00,0x00,0x00,0x00,0x00,0x00,0x00,0x00,0x00,
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 0x00,0x00,0x00,0x00,0x00,0x00,0x00,0x00,0x00,0x00,0xFF};

// =========================================================================
// BMP dimension macros (read width/height from BMP header bytes)
// =========================================================================
#define BUNKERW     ((uint8_t)Bunker0[18])
#define BUNKERH     ((uint8_t)Bunker0[22])
#define ENEMY30W    ((uint8_t)SmallEnemy30PointA[18])
#define ENEMY30H    ((uint8_t)SmallEnemy30PointA[22])
#define ENEMY20W    ((uint8_t)SmallEnemy20PointA[18])
#define ENEMY20H    ((uint8_t)SmallEnemy20PointA[22])
#define ENEMY10W    ((uint8_t)SmallEnemy10PointA[18])
#define ENEMY10H    ((uint8_t)SmallEnemy10PointA[22])
#define ENEMYBONUSW ((uint8_t)SmallEnemyBonus0[18])
#define ENEMYBONUSH ((uint8_t)SmallEnemyBonus0[22])
#define LASERW      ((uint8_t)Laser0[18])
#define LASERH      ((uint8_t)Laser0[22])
#define MISSILEW    ((uint8_t)Missile0[18])
#define MISSILEH    ((uint8_t)Missile0[22])
#define PLAYERW     ((uint8_t)PlayerShip0[18])
#define PLAYERH     ((uint8_t)PlayerShip0[22])

// =========================================================================
// Game object arrays  (STyp defined in game_types.h)
// =========================================================================
STyp Enemy[8];
STyp Bunker;
STyp Player;
STyp Missile[9];   // [0-7] = enemy missiles, [8] = player missile
STyp Laser[9];     // [0-7] = enemy lasers,   [8] = player laser
STyp UFO;

// =========================================================================
// Convert — ADC 12-bit → player X position  (0 to SCREENW-PLAYERW = 0-110)
//
// Original: (66 * sample) / 4095  where 66 = 84  - PLAYERW(18)
// STM32:   (110 * sample) / 4095  where 110 = 128 - PLAYERW(18)
// =========================================================================
uint32_t Convert(uint32_t sample) {
    return (110U * sample) / 4095U;
}

// =========================================================================
// Game object initializers
// =========================================================================

void UFO_Init(void) {
    UFO.x = 0;
    UFO.y = 10;
    UFO.maxpoint[0] = UFO.x + ENEMYBONUSW;
    UFO.maxpoint[1] = UFO.y + ENEMYBONUSH;
    UFO.image[0] = SmallEnemyBonus0;
    UFO.image[1] = SmallExplosion0;
    UFO.life = 1;
    UFO.deathCounter = 3;
    Sound_Highpitch();
}

void UFO_Move(void) {
    if (UFO.life > 0 && UFO.x < 126U) {   // 126 = SCREENW-2
        UFO.x += 3;
        UFO.maxpoint[0] += 3;
    } else {
        UFO.life = 0;
    }
}

void Enemy_Init(void) {
    int i;
    for (i = 0; i < (int)numEnemies; i++) {
        Enemy[i].x = 15U * (uint32_t)(i % 4);
        if (i < 4) {
            Enemy[i].y = 10;
            Enemy[i].maxpoint[0] = Enemy[i].x + ENEMY30W;
            Enemy[i].maxpoint[1] = Enemy[i].y + ENEMY30H;
            Enemy[i].image[0] = SmallEnemy30PointA;
            Enemy[i].image[1] = SmallEnemy30PointB;
        } else if (i >= 4 || i < 8) {
            Enemy[i].y = 10 + ENEMY30H;
            Enemy[i].maxpoint[0] = Enemy[i].x + ENEMY10W;
            Enemy[i].maxpoint[1] = Enemy[i].y + ENEMY10H;
            Enemy[i].image[0] = SmallEnemy10PointA;
            Enemy[i].image[1] = SmallEnemy10PointB;
        } else {
            Enemy[i].y = 10 + ENEMY30H + ENEMY20H;
            Enemy[i].maxpoint[0] = Enemy[i].x + ENEMY20W;
            Enemy[i].maxpoint[1] = Enemy[i].y + ENEMY20H;
            Enemy[i].image[0] = SmallEnemy20PointA;
            Enemy[i].image[1] = SmallEnemy20PointB;
        }
        Enemy[i].life = 1;
        Enemy[i].deathCounter = 3;
    }
}

void Enemy_Move(void) {
    int i;
    int minY = 64;   // SCREENH = 64
    for (i = 0; i < (int)numEnemies; i++) {
        Enemy[i].x = (uint32_t)((int32_t)Enemy[i].x + enemyDir);
        Enemy[i].maxpoint[0] = (uint32_t)((int32_t)Enemy[i].maxpoint[0] + enemyDir);
        Enemy[i].y += enemyDrop;
        Enemy[i].maxpoint[1] += enemyDrop;
        if ((int)Enemy[i].y < minY) minY = (int)Enemy[i].y;
    }
    enemyDrop = 0;
    for (i = 0; i < (int)numEnemies; i++) {
        if (Enemy[i].life > 0) {
            if (Enemy[i].maxpoint[0] >= 126U) {
                enemyDir  = (-1) * (int32_t)currentLevel;
                enemyDrop = 2;
            }
            if ((int32_t)Enemy[i].x <= 0) {
                Enemy[i].x = 0;
                enemyDir  = 1 * (int32_t)currentLevel;
                enemyDrop = 2;
            }
        }
    }
    if (minY > 20 && UFO.life <= 0 && randomnum > 8 && randomnum <= 10) {
        UFO_Init();
    }
}

void Bunker_Init(void) {
    Bunker.x = 55U;                          // centered: (128-18)/2 = 55
    Bunker.y = 63U - PLAYERH;               // just above player
    Bunker.maxpoint[0] = Bunker.x + BUNKERW;
    Bunker.maxpoint[1] = Bunker.y + BUNKERH;
    Bunker.image[0] = Bunker0;
    Bunker.image[1] = Bunker1;
    Bunker.image[2] = Bunker2;
    Bunker.image[3] = Bunker3;
    Bunker.life = 10;
}

void Player_Init(void) {
    Player.x = 55U;                          // centered
    Player.y = 63U;                          // bottom row = 63
    Player.maxpoint[0] = Player.x + PLAYERW;
    Player.maxpoint[1] = Player.y + PLAYERH;
    Player.image[0] = PlayerShip0;
    Player.image[1] = BigExplosion0;
    Player.life = 20;
    Player.deathCounter = 3;
}

void Player_Move(uint32_t position) {
    Player.x = position;
    Player.maxpoint[0] = Player.x + PLAYERW;
}

void Player_Missile_Init(void) {
    Missile[playMissile].x = Player.x + (PLAYERW / 2U);
    Missile[playMissile].y = Player.y - 4U;
    Missile[playMissile].maxpoint[0] = Missile[playMissile].x + MISSILEW;
    Missile[playMissile].maxpoint[1] = Missile[playMissile].y + MISSILEH;
    Missile[playMissile].image[0] = Missile0;
    Missile[playMissile].image[1] = Missile2;
    Missile[playMissile].life = 1;
    Missile[playMissile].deathCounter = 3;
    Sound_Shoot();
}

void Enemy_Missile_Init(void) {
    int i;
    for (i = 0; i < (int)numEnemies; i++) {
        if ((Enemy[i].life > 0) && (Missile[i].life <= 0) && ((i + 2) == (int)randomnum)) {
            if ((i >= 4) || (Enemy[i % 4].life <= 0)) {
                Missile[i].x = Enemy[i].x + (ENEMY30W / 2U);
                Missile[i].y = Enemy[i].y + 4U;
                Missile[i].maxpoint[0] = Missile[i].x + MISSILEW;
                Missile[i].maxpoint[1] = Missile[i].y + MISSILEH;
                Missile[i].image[0] = Missile0;
                Missile[i].image[1] = Missile2;
                Missile[i].life = 1;
                Missile[i].deathCounter = 3;
            }
        }
    }
}

void Missile_Move(void) {
    if ((Missile[playMissile].life == 1) && (Missile[playMissile].y <= 64U)) {
        Missile[playMissile].y -= 3U;
        Missile[playMissile].maxpoint[1] -= 3U;
    } else {
        Missile[playMissile].life = 0;
    }
}

void Enemy_Missile_Move(void) {
    int i;
    for (i = 0; i < (int)numEnemies; i++) {
        if ((Missile[i].life == 1) && (Missile[i].y <= 64U)) {
            Missile[i].y += 3U;
            Missile[i].maxpoint[1] += 3U;
        } else {
            Missile[i].life = 0;
        }
    }
}

void Player_Laser_Init(void) {
    Laser[playLaser].x = Player.x + (PLAYERW / 2U);
    Laser[playLaser].y = Player.y - 4U;
    Laser[playLaser].maxpoint[0] = Laser[playLaser].x + LASERW;
    Laser[playLaser].maxpoint[1] = Laser[playLaser].y + LASERH;
    Laser[playLaser].image[0] = Laser0;
    Laser[playLaser].image[1] = Laser1;
    Laser[playLaser].life = 1;
    Laser[playLaser].deathCounter = 3;
    Sound_Shoot();
}

void Enemy_Laser_Init(void) {
    int i;
    for (i = 0; i < (int)numEnemies; i++) {
        if ((Enemy[i].life > 0) && (Laser[i].life <= 0) && ((i + 3) == (int)randomnum)) {
            if ((i >= 4) || (Enemy[i % 4].life <= 0)) {
                Laser[i].x = Enemy[i].x + (ENEMY30W / 2U);
                Laser[i].y = Enemy[i].y + 4U;
                Laser[i].maxpoint[0] = Laser[i].x + LASERW;
                Laser[i].maxpoint[1] = Laser[i].y + LASERH;
                Laser[i].image[0] = Laser0;
                Laser[i].image[1] = Laser1;
                Laser[i].life = 1;
                Laser[i].deathCounter = 3;
            }
        }
    }
}

void Laser_Move(void) {
    if ((Laser[playLaser].life == 1) && (Laser[playLaser].y <= 64U)) {
        Laser[playLaser].y -= 4U;
        Laser[playLaser].maxpoint[1] -= 4U;
    } else {
        Laser[playLaser].life = 0;
    }
}

void Enemy_Laser_Move(void) {
    int i;
    for (i = 0; i < (int)numEnemies; i++) {
        if ((Laser[i].life == 1) && (Laser[i].y <= 64U)) {
            Laser[i].y += 4U;
            Laser[i].maxpoint[1] += 4U;
        } else {
            Laser[i].life = 0;
        }
    }
}

// =========================================================================
// Check_Damage — collision detection (identical to original)
// =========================================================================
void Check_Damage(void) {
    int i, j;
    // enemy missiles/lasers vs bunker
    for (j = 0; j < (int)numEnemies; j++) {
        if ((Missile[j].life == 1) && (Bunker.life > 0)
         && ((Bunker.x - 2U) <= Missile[j].x)
         && (Missile[j].x <= (Bunker.maxpoint[0] + 2U))
         && ((Bunker.y + 10U) <= Missile[j].maxpoint[1])) {
            Bunker.life -= 2;
            Missile[j].life = 0;
        }
        if ((Laser[j].life == 1) && (Bunker.life > 0)
         && ((Bunker.x - 2U) <= Laser[j].x)
         && (Laser[j].x <= (Bunker.maxpoint[0] + 2U))
         && ((Bunker.y + 10U) <= Laser[j].maxpoint[1])) {
            Bunker.life -= 1;
            Laser[j].life = 0;
        }
    }
    // player missile vs bunker
    if ((Missile[playMissile].life == 1) && (Bunker.life > 0)
     && ((Bunker.x - 2U) <= Missile[playMissile].x)
     && (Missile[playMissile].x <= (Bunker.maxpoint[0] + 2U))) {
        Bunker.life -= 2;
        Missile[playMissile].life = 0;
    }
    // player laser vs bunker
    if ((Laser[playLaser].life == 1) && (Bunker.life > 0)
     && ((Bunker.x - 2U) <= Laser[playLaser].x)
     && (Laser[playLaser].x <= (Bunker.maxpoint[0] + 2U))) {
        Bunker.life -= 1;
        Laser[playLaser].life = 0;
    }
    // enemy missiles/lasers vs player
    for (j = 0; j < (int)numEnemies; j++) {
        if ((Missile[j].life == 1) && (Player.life > 0)
         && (Player.x <= Missile[j].x)
         && (Missile[j].x <= Player.maxpoint[0])
         && (Player.y <= Missile[j].maxpoint[1])) {
            Player.life -= 2;
            Missile[j].life = 0;
            Sound_Explosion();
        }
        if ((Laser[j].life == 1) && (Player.life > 0)
         && (Player.x <= Laser[j].x)
         && (Laser[j].x <= Player.maxpoint[0])
         && (Player.y <= Laser[j].maxpoint[1])) {
            Player.life -= 1;
            Laser[j].life = 0;
            Sound_Explosion();
        }
    }
    // player missile/laser vs enemies
    for (i = 0; i < (int)numEnemies; i++) {
        if ((Missile[playMissile].life == 1) && (Enemy[i].life > 0)
         && (Enemy[i].x <= Missile[playMissile].x)
         && (Missile[playMissile].x <= Enemy[i].maxpoint[0])
         && (Enemy[i].y <= Missile[playMissile].y)
         && (Missile[playMissile].y <= Enemy[i].maxpoint[1])) {
            Enemy[i].life -= 2;
            Missile[playMissile].life = 0;
            Sound_Killed();
        }
        if ((Laser[playLaser].life == 1) && (Enemy[i].life > 0)
         && (Enemy[i].x <= Laser[playLaser].x)
         && (Laser[playLaser].x <= Enemy[i].maxpoint[0])
         && (Enemy[i].y <= Laser[playLaser].y)
         && (Laser[playLaser].y <= Enemy[i].maxpoint[1])) {
            Enemy[i].life -= 1;
            Laser[playLaser].life = 0;
            Sound_Killed();
        }
        if (Enemy[i].life <= 0) {
            Enemy[i].image[0] = SmallExplosion0;
            Enemy[i].image[1] = SmallExplosion1;
            if (Enemy[i].deathCounter > 0) Enemy[i].deathCounter--;
        }
    }
    // player missile/laser vs enemy missiles/lasers
    for (i = 0; i < (int)numEnemies; i++) {
        if ((Missile[playMissile].life == 1)
         && (Missile[i].x <= Missile[playMissile].x)
         && (Missile[playMissile].x <= Missile[i].maxpoint[0])
         && (Missile[i].y <= Missile[playMissile].y)
         && (Missile[playMissile].y <= Missile[i].maxpoint[1])) {
            Missile[i].life = 0;
            Missile[playMissile].life = 0;
        }
        if ((Laser[playLaser].life == 1)
         && (Laser[i].x <= Laser[playLaser].x)
         && (Laser[playLaser].x <= Laser[i].maxpoint[0])
         && (Laser[i].y <= Laser[playLaser].y)
         && (Laser[playLaser].y <= Laser[i].maxpoint[1])) {
            Laser[i].life = 0;
            Laser[playLaser].life = 0;
        }
    }
    // player death state
    if (Player.life <= 0) {
        Player.image[0] = BigExplosion0;
        Player.image[1] = BigExplosion1;
        if (Player.deathCounter > 0) Player.deathCounter--;
    }
    // player missile/laser vs UFO
    if ((Missile[playMissile].life == 1) && (UFO.life > 0)
     && (UFO.x <= Missile[playMissile].x)
     && (Missile[playMissile].x <= UFO.maxpoint[0])
     && (UFO.y <= Missile[playMissile].y)
     && (Missile[playMissile].y <= UFO.maxpoint[1])) {
        UFO.life -= 2;
        Missile[playMissile].life = 0;
        Sound_Killed();
    }
    if ((Laser[playLaser].life == 1) && (UFO.life > 0)
     && (UFO.x <= Laser[playLaser].x)
     && (Laser[playLaser].x <= UFO.maxpoint[0])
     && (UFO.y <= Laser[playLaser].y)
     && (Laser[playLaser].y <= UFO.maxpoint[1])) {
        UFO.life -= 1;
        Laser[playLaser].life = 0;
        Sound_Killed();
    }
    if (UFO.life <= 0) {
        UFO.image[0] = SmallExplosion0;
        UFO.image[1] = SmallExplosion1;
        if (UFO.deathCounter > 0) UFO.deathCounter--;
    }
}

// =========================================================================
// Draw — clear buffer, blit all sprites, push to OLED
// (Nokia5110_* → SSD1306_*; logic unchanged)
// =========================================================================
void Draw(void) {
    int i;
    SSD1306_ClearBuffer();
    Check_Damage();

    // enemies
    for (i = 0; i < (int)numEnemies; i++) {
        if (Enemy[i].life > 0) {
            SSD1306_PrintBMP(Enemy[i].x, Enemy[i].y, Enemy[i].image[FrameCount], 0);
        } else if (Enemy[i].deathCounter > 0) {
            SSD1306_PrintBMP(Enemy[i].x, Enemy[i].y, Enemy[i].image[0], 0);
        } else {
            SSD1306_PrintBMP(Enemy[i].x, Enemy[i].y, Enemy[i].image[1], 0);
        }
    }
    // bunker
    if      (Bunker.life >= 7) SSD1306_PrintBMP(Bunker.x, Bunker.y, Bunker.image[0], 0);
    else if (Bunker.life >= 4) SSD1306_PrintBMP(Bunker.x, Bunker.y, Bunker.image[1], 0);
    else if (Bunker.life >= 1) SSD1306_PrintBMP(Bunker.x, Bunker.y, Bunker.image[2], 0);
    else                       SSD1306_PrintBMP(Bunker.x, Bunker.y, Bunker.image[3], 0);

    // player
    if (Player.life > 0) {
        SSD1306_PrintBMP(Player.x, Player.y, Player.image[0], 0);
    } else if (Player.deathCounter > 0) {
        SSD1306_PrintBMP(Player.x, Player.y, Player.image[0], 0);
    } else {
        SSD1306_PrintBMP(Player.x, Player.y, Player.image[1], 0);
    }
    // UFO
    if (UFO.life > 0) {
        SSD1306_PrintBMP(UFO.x, UFO.y, UFO.image[0], 0);
    } else if (UFO.deathCounter > 0) {
        SSD1306_PrintBMP(UFO.x, UFO.y, UFO.image[0], 0);
    } else {
        SSD1306_PrintBMP(UFO.x, UFO.y, UFO.image[1], 0);
    }
    // missiles and lasers
    for (i = 0; i < (int)(numEnemies + 1U); i++) {
        if (Missile[i].life == 1) SSD1306_PrintBMP(Missile[i].x, Missile[i].y, Missile[i].image[0], 0);
        if (Laser[i].life   == 1) SSD1306_PrintBMP(Laser[i].x,   Laser[i].y,   Laser[i].image[0],   0);
    }
    SSD1306_DisplayBuffer();
    FrameCount = (FrameCount + 1U) & 0x01U;   // 0,1,0,1,…
}

// =========================================================================
// Game_Over — freeze display with "GAME OVER" message
// Delay100ms(2) → HAL_Delay(200U)
// =========================================================================
void Game_Over(void) {
    HAL_Delay(100U);
    SSD1306_ClearBuffer();
    SSD1306_SetCursor(2, 2);
    SSD1306_OutString("GAME OVER");
    SSD1306_SetCursor(2, 4);
    SSD1306_OutString("Nice try,");
    SSD1306_SetCursor(2, 5);
    SSD1306_OutString("Earthling!");
    SSD1306_DisplayBuffer();
    while (1);   // halt
}

// =========================================================================
// Level_Check — advance level or trigger Game Over
// Delay100ms(2) → HAL_Delay(200U)
// Delay100ms(5) → HAL_Delay(500U)
// =========================================================================
void Level_Check(void) {
    int i;
    int enemiesDead = 0;
    if (Player.life <= 0 && Player.deathCounter <= 0) Game_Over();
    for (i = 0; i < (int)numEnemies; i++) {
        if (Enemy[i].life <= 0) enemiesDead++;
        if ((Enemy[i].maxpoint[1] >= Player.y) && (Enemy[i].life > 0)) Game_Over();
    }
    if (enemiesDead == (int)numEnemies) {
        currentLevel++;
        enemyDir = (int32_t)currentLevel;
        HAL_Delay(100U);
        SSD1306_ClearBuffer();
        SSD1306_SetCursor(3, 2);
        SSD1306_OutString("LEVEL");
        SSD1306_SetCursor(10, 2);
        SSD1306_OutUDec((uint16_t)currentLevel);
        SSD1306_DisplayBuffer();
        HAL_Delay(500U);
        Enemy_Init();
        Bunker_Init();
        Player_Init();
    }
}
