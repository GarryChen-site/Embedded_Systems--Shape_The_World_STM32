// ssd1306_hal.c — SSD1306 OLED 128×64 driver (HAL version), Lab 15
//
// HAL port of ssd1306.c.  Replaces bare-metal I2C register twiddling with
// HAL_I2C_Master_Transmit(&hi2c1, ...).
//
// KEY DIFFERENCES FROM BARE-METAL ssd1306.c:
//   - No I2C GPIO init (CubeIDE generates MX_I2C1_Init → HAL_I2C_MspInit)
//   - DevAddress = SSD1306_I2C_ADDR = 0x78 (7-bit 0x3C << 1)
//   - ssd1306_cmd_stream uses a local stack buffer (≤32 cmd bytes)
//   - SSD1306_DisplayBuffer uses a static 1025-byte tx_buf (avoids 1 kB stack)
//   - SSD1306_Init calls HAL_Delay(10) for VCC settle instead of spin-loop
//   - All drawing / BMP / font logic is unchanged from the bare-metal version

#include "ssd1306_hal.h"
#include "stm32f4xx_hal.h"
#include <string.h>

extern I2C_HandleTypeDef hi2c1;   // declared by CubeIDE in main.c

// =========================================================================
// Frame buffer and TX buffer
// =========================================================================
uint8_t  ScreenBuffer[SCREENW * (SCREENH / 8)];  // 1024 bytes
static uint8_t tx_buf[1025];                      // 1 control + 1024 data

// Cursor position (character units)
static uint8_t CursorX = 0;
static uint8_t CursorY = 0;

// =========================================================================
// 5×8 pixel ASCII font — 96 glyphs (0x20 space … 0x7F DEL)
// Identical to the bare-metal ssd1306.c version
// =========================================================================
static const uint8_t Font5x8[][5] = {
    {0x00,0x00,0x00,0x00,0x00}, // 0x20 space
    {0x00,0x00,0x5F,0x00,0x00}, // 0x21 !
    {0x00,0x07,0x00,0x07,0x00}, // 0x22 "
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    {0x00,0x00,0x00,0x00,0x00}, // 0x7F DEL
};

// =========================================================================
// Internal helpers — HAL I2C transmit wrappers
// =========================================================================

// Send a stream of command bytes in one transaction
// buf layout: [0x00 (control)] [cmd0] [cmd1] ... [cmdN-1]
// n: number of COMMAND bytes (not counting the control byte)
#define CMD_MAX 32U
static void ssd1306_cmd_stream(const uint8_t *cmds, uint32_t n) {
    uint8_t buf[CMD_MAX + 1U];
    if (n > CMD_MAX) n = CMD_MAX;
    buf[0] = 0x00U;   // Co=0, D/C#=0 → command stream
    for (uint32_t i = 0U; i < n; i++) buf[i + 1U] = cmds[i];
    HAL_I2C_Master_Transmit(&hi2c1, SSD1306_I2C_ADDR,
                            buf, (uint16_t)(n + 1U), 10U);
}

// =========================================================================
// SSD1306_Init
// =========================================================================
void SSD1306_Init(void) {
    // I2C1 GPIO and peripheral already initialised by CubeIDE MX_I2C1_Init()
    HAL_Delay(10U);   // wait for OLED VCC to settle

    static const uint8_t init_cmds[] = {
        0xAE,             // Display OFF
        0x20, 0x00,       // Horizontal addressing mode
        0x21, 0x00, 0x7F, // Column 0-127
        0x22, 0x00, 0x07, // Page 0-7
        0x40,             // Start line = 0
        0xA1,             // Segment re-map (mirror X)
        0xA8, 0x3F,       // Multiplex ratio: 64
        0xC8,             // COM scan direction: reverse (mirror Y)
        0xD3, 0x00,       // Display offset: 0
        0xDA, 0x12,       // COM pins: sequential
        0xD5, 0x80,       // Oscillator / divide ratio
        0xD9, 0xF1,       // Pre-charge period
        0xDB, 0x40,       // VCOMH deselect level
        0x81, 0xCF,       // Contrast: 207
        0xA4,             // Resume from GDDRAM
        0xA6,             // Normal display (not inverted)
        0x8D, 0x14,       // Charge pump: enable
        0xAF,             // Display ON
    };
    ssd1306_cmd_stream(init_cmds, sizeof(init_cmds));

    SSD1306_ClearBuffer();
    SSD1306_DisplayBuffer();
}

// =========================================================================
// SSD1306_ClearBuffer
// =========================================================================
void SSD1306_ClearBuffer(void) {
    for (uint32_t i = 0U; i < sizeof(ScreenBuffer); i++)
        ScreenBuffer[i] = 0x00U;
}

// =========================================================================
// SSD1306_DisplayBuffer — flush ScreenBuffer to OLED in one I2C transaction
// =========================================================================
void SSD1306_DisplayBuffer(void) {
    static const uint8_t addr_cmds[] = {
        0x21, 0x00, 0x7F,   // column 0-127
        0x22, 0x00, 0x07,   // page 0-7
    };
    ssd1306_cmd_stream(addr_cmds, sizeof(addr_cmds));

    // tx_buf[0] = DATA control byte (0x40); tx_buf[1..1024] = frame buffer
    tx_buf[0] = 0x40U;
    memcpy(&tx_buf[1], ScreenBuffer, sizeof(ScreenBuffer));
    HAL_I2C_Master_Transmit(&hi2c1, SSD1306_I2C_ADDR, tx_buf, 1025U, 100U);
}

// =========================================================================
// SSD1306_PrintBMP — decode a 4-bit LM3S BMP into ScreenBuffer
//
// BMP rows are stored bottom-to-top, 2 pixels/byte (high nibble = left).
// ypos = bottom row of sprite on screen; xpos = left column.
// =========================================================================
void SSD1306_PrintBMP(uint8_t xpos, uint8_t ypos,
                      const uint8_t *ptr, uint8_t threshold) {
    uint8_t  width  = ptr[18];
    uint8_t  height = ptr[22];

    uint32_t bytes_per_row = ((uint32_t)width + 1U) / 2U;
    uint32_t stride        = ((bytes_per_row + 3U) / 4U) * 4U;
    const uint8_t *pixels  = ptr + 118U;

    for (uint8_t r = 0U; r < height; r++) {
        int32_t sy = (int32_t)ypos - (int32_t)r;
        if (sy < 0 || sy >= (int32_t)SCREENH) continue;

        uint32_t page = (uint32_t)sy / 8U;
        uint8_t  bit  = (uint8_t)((uint32_t)sy % 8U);

        for (uint8_t c = 0U; c < width; c++) {
            uint32_t sx = (uint32_t)xpos + (uint32_t)c;
            if (sx >= (uint32_t)SCREENW) continue;

            uint8_t raw   = pixels[r * stride + c / 2U];
            uint8_t color = (c % 2U == 0U) ? (raw >> 4) & 0x0FU
                                            :  raw       & 0x0FU;
            if (color > threshold)
                ScreenBuffer[page * (uint32_t)SCREENW + sx] |= (uint8_t)(1U << bit);
        }
    }
}

// =========================================================================
// Text output
// =========================================================================
void SSD1306_Clear(void) {
    SSD1306_ClearBuffer();
    SSD1306_DisplayBuffer();
    CursorX = 0;
    CursorY = 0;
}

void SSD1306_SetCursor(uint8_t x, uint8_t y) {
    CursorX = x;
    CursorY = y & 0x07U;
}

void SSD1306_OutChar(char c) {
    if ((uint8_t)c < 0x20U || (uint8_t)c > 0x7FU) c = ' ';
    const uint8_t *glyph = Font5x8[(uint8_t)c - 0x20U];

    uint32_t col  = (uint32_t)CursorX * 6U;
    uint32_t page = (uint32_t)CursorY;

    if (col + 6U > (uint32_t)SCREENW || page > 7U) return;

    for (uint8_t i = 0U; i < 5U; i++)
        ScreenBuffer[page * (uint32_t)SCREENW + col + i] = glyph[i];
    ScreenBuffer[page * (uint32_t)SCREENW + col + 5U] = 0x00U;

    CursorX++;
    if ((uint32_t)CursorX * 6U >= (uint32_t)SCREENW) {
        CursorX = 0;
        if (CursorY < 7U) CursorY++;
    }
}

void SSD1306_OutString(const char *str) {
    while (*str) SSD1306_OutChar(*str++);
}

void SSD1306_OutUDec(uint16_t n) {
    char    buf[6] = {'0','0','0','0','0','\0'};
    uint8_t i = 5U;
    do {
        buf[--i] = (char)('0' + (n % 10U));
        n = (uint16_t)(n / 10U);
    } while (n && i > 0U);
    SSD1306_OutString(&buf[i]);
}
