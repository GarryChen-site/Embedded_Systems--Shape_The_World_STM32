
#include "ssd1306.h"
#include <stdint.h>

#define RCC_AHB1ENR (*((volatile uint32_t *)0x40023830U))
#define RCC_APB1ENR (*((volatile uint32_t *)0x40023840U))

#define GPIOB_MODER (*((volatile uint32_t *)0x40020400U))
#define GPIOB_OTYPER (*((volatile uint32_t *)0x40020404U))
#define GPIOB_OSPEEDR (*((volatile uint32_t *)0x40020408U))
#define GPIOB_PUPDR (*((volatile uint32_t *)0x4002040CU))
#define GPIOB_AFRH (*((volatile uint32_t *)0x40020424U))
// ================================
// I2C1 registers
// ================================
#define I2C1_CR1 (*((volatile uint32_t *)0x40005400U))
#define I2C1_CR2 (*((volatile uint32_t *)0x40005404U))
#define I2C1_DR (*((volatile uint32_t *)0x40005410U))
#define I2C1_SR1 (*((volatile uint32_t *)0x40005414U))
#define I2C1_SR2 (*((volatile uint32_t *)0x40005418U))
#define I2C1_CCR (*((volatile uint32_t *)0x4000541CU))
#define I2C1_TRISE (*((volatile uint32_t *)0x40005420U))

// I2C1_SR1 bits
#define I2C_SR1_SB (1U << 0)
#define I2C_SR1_ADDR (1U << 1)
#define I2C_SR1_BTF (1U << 2)
#define I2C_SR1_TXE (1U << 7)

// I2C1_CR1 bits
#define I2C_CR1_PE (1U << 0);
#define I2C_CR1_START (1U << 8);
#define I2C_CR1_STOP (1U << 9);
#define I2C_CR1_SWRST (1U << 15);

// ==================================================
// Frame buffer - 128 columns x 8 pages = 1024 bytes
// ==================================================
uint8_t ScreenBuffer[SCREENW * (SCREENH / 8)];

// ==================================================
// Text cursor (character units)
// ==================================================
static uint8_t CursorX = 0;
static uint8_t CursorY = 0;

// =========================================================================
// 5×8 pixel font — 96 glyphs (0x20 space … 0x7F)
// =========================================================================
static const uint8_t Font5x8[][5] = {
    {0x00, 0x00, 0x00, 0x00, 0x00}, // 0x20 space
    {0x00, 0x00, 0x5F, 0x00, 0x00}, // 0x21 !
    {0x00, 0x07, 0x00, 0x07, 0x00}, // 0x22 "
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    {0x1F, 0x24, 0x7C, 0x24, 0x1F}, // 0x7F (UT sign)
};

// ======================================
// Low-level I2C1 primitives
// ======================================

static void i2c1_start(void) {
  I2C1_CR1 |= I2C_CR1_START;
  while (!(I2C1_SR1 & I2C_SR1_SB))
    ;
}

// Send　7-bit address + W bit
static void i2c1_addr(uint8_t addr7) {
  I2C1_DR = (uint32_t)(addr7 << 1);
  while (!(I2C1_SR1 & I2C_SR1_ADDR))
    ;
  (void)I2C1_SR1;
  (void)I2C1_SR2;
}

// Send one byte
// Waits for TXE (DR empty) before writing
static void i2c1_byte(uint8_t b) {
  while (!(I2C1_SR1 & I2C_SR1_TXE))
    ;
  I2C1_DR = (uint32_t)b;
}

// Generate STOP after ensuring last byte is fully transmitted
static void i2c1_stop(void) {
  while (!(I2C1_SR1 & I2C_SR1_TXE))
    ;
  while (!(I2C1_SR1 & I2C_SR1_BTF))
    ;
  I2C1_CR1 |= I2C_CR1_STOP;
}

// ==================================================
// SSD1306 command helpers
// ==================================================

static void ssd1306_cmd_stream(const uint8_t *cmds, uint32_t n) {
  i2c1_start();
  i2c1_addr(SSD1306_I2C_ADDR);
  i2c1_byte(0x00U); // A control byte mainly consists of Co and D/C# bits
                    // following by six “0” ‘s.
  for (uint32_t i = 0U; i < n; i++) {
    i2c1_byte(cmds[i]);
  }
  i2c1_stop();
}

// ==========================================================
// SSD1306_Init - configure I2C1 and initialize the display
// ==========================================================
void SSD1306_Init(void) {

  // 1. Enable clocks
  RCC_AHB1ENR |= (1U << 1);
  RCC_APB1ENR |= (1U << 21);

  // 2. Configure PB8 (SCL) and PB9 (SDA)
  //    AF mode (MODER=10), open-drain (OTYPER=1), high-speed (OSPEEDR=11)
  //    Pull-up (PUPDR=01), AF4 (AFRH)
  GPIOB_MODER &= ~((3U << 16) | (3U << 18)); // clear PB8/PB9
  GPIOB_MODER |= ((2U << 16) | (2U << 18));  // AF mode
  GPIOB_OTYPER |= (1U << 8) | (1U << 9);     // open-drain
  GPIOB_OSPEEDR |= (3U << 16) | (3U << 18);  // high speed
  GPIOB_PUPDR &= ~((3U << 16) | (3U << 18));
  GPIOB_PUPDR |= (1U << 16) | (1U << 18); // pull-up
  GPIOB_AFRH &= ~(0xFFU);                 // clear AF for PB8+PB9
  GPIOB_AFRH |= (4U << 0) | (4U << 4);    // AF4 = I2C1

  // 3. Reset I2C1
  I2C1_CR1 |= I2C_CR1_SWRST;
  I2C1_CR1 &= ~I2C_CR1_SWRST;

  // 4. Configure I2C1 for 400kHz Fast mode
  //    FREQ  = 16 (MHz, matches PCLK1)
  //    F/S=1 (fast mode), DUTY=0, CCR=14
  //      → Tscl = 3 × 14 × (1/16MHz) = 2625 ns → ~381 kHz
  //    TRISE = floor(300ns × 16MHz) + 1 = 4+1 = 5
  I2C1_CR2 = 16U;
  I2C1_CCR = (1U << 15) | 14U; // F/S=1, DUTY=0, CCR=14
  I2C1_TRISE = 5U;
  I2C1_CR1 = I2C_CR1_PE; // enable I2C1

  // Small settling delay after PE=1
  for (volatile uint32_t d = 0; d < 1000U; d++)
    ;

  // 5. SSD1306 initialization sequence (128×64) ---------------------
  static const uint8_t init_cmds[] = {
      0xAE,             // Display OFF
      0x20, 0x00,       // Horizontal addressing mode
      0x21, 0x00, 0x7F, // Column address 0-127
      0x22, 0x00, 0x07, // Page address 0-7
      0x40,             // Start line = 0
      0xA1,             // Segment re-map: col 127 → SEG0  (mirror X)
      0xA8, 0x3F,       // Multiplex ratio: 64 (0x3F)
      0xC8,             // COM scan direction: reverse  (mirror Y)
      0xD3, 0x00,       // Display offset: 0
      0xDA, 0x12,       // COM pins: sequential, disable COM left/right remap
      0xD5, 0x80,       // Oscillator freq / divide ratio
      0xD9, 0xF1,       // Pre-charge: 15 clocks phase2, 1 clock phase1
      0xDB, 0x40,       // VCOMH deselect: ~0.77 × Vcc
      0x81, 0xCF,       // Contrast: 207/255
      0xA4,             // Entire display ON from RAM (not force-on)
      0xA6,             // Normal display (not inverted)
      0x8D, 0x14,       // Charge pump: enable (required for internal VCC)
      0xAF,             // Display ON
  };
  ssd1306_cmd_stream(init_cmds, sizeof(init_cmds));

  // 6. Start with a blank screen
  SSD1306_ClearBuffer();
  SSD1306_DisplayBuffer();
}

// ==========================================================
// SSD1306_ClearBuffer - zero the frame buffer (black screen)
// ==========================================================
void SSD1306_ClearBuffer(void) {
  for (uint32_t i = 0U; i < sizeof(ScreenBuffer); i++) {
    ScreenBuffer[i] = 0x00U;
  }
}

// ==========================================================
// SSD1306_DisplayBuffer - send 1024-byte buffer to OLED
// ==========================================================
void SSD1306_DisplayBuffer(void) {
  // Reset column/page pointers to full screen (horizontal addressing mode)
  static const uint8_t addr[] = {0x21, 0x00, 0x7F, 0x22, 0x00, 0x07};
  ssd1306_cmd_stream(addr, sizeof(addr));

  // Send all 1024 bytes as one data stream
  // Control byte 0x40: Co=0 (stream), D/C#=1 (data)
  i2c1_start();
  i2c1_addr(SSD1306_I2C_ADDR);
  i2c1_byte(0x40U);
  for (uint32_t i = 0U; i < sizeof(ScreenBuffer); i++) {
    i2c1_byte(ScreenBuffer[i]);
  }
  i2c1_stop();
}

// ==========================================================
// Text output functions
// ==========================================================

void SSD1306_Clear(void) {
  SSD1306_ClearBuffer();
  SSD1306_DisplayBuffer();
  CursorX = 0;
  CursorY = 0;
}

void SSD1306_SetCursor(uint8_t x, uint8_t y) {
  CursorX = x;
  CursorY = y & 0x07U;
}

void SSD1306_OutChar(char c) {
  if ((uint8_t)c < 0x20U || (uint8_t)c > 0x7FU) {
    c = ' ';
  }

  const uint8_t *glyph = Font5x8[(uint8_t)c - 0x20U];

  uint32_t col = (uint32_t)CursorX * 6U; // 5px wide + 1px gap
  uint32_t page = (uint32_t)CursorY;     // 8-row band

  if ((col + 6U > (uint32_t)SCREENW) || page > 7U) {
    return;
  }

  for (uint8_t i = 0U; i < 5U; i++) {
    ScreenBuffer[page * 128 + col + i] = glyph[i];
  }

  ScreenBuffer[page * 128 + col + 5U] = 0x00U;

  CursorX++;
  if ((uint32_t)CursorX * 6U >= (uint32_t)SCREENW) {
    CursorX = 0;
    if (CursorY < 7) {
      CursorY++;
    }
  }
}

void SSD1306_OutString(const char *str) {
  while (*str)
    SSD1306_OutChar(*str++);
}

void SSD1306_OutDec(uint16_t n) {
  char buf[6]; // max "65535\0"
  uint8_t i = 5U;
  buf[5] = '\0';

  do {
    buf[--i] = (char)((n % 10U) + '0');
    n = (uint16_t)(n / 10U);
  } while (n && i > 0U);

  SSD1306_OutString(&buf[i]);
}