#include "sound_stm32.h"
#include <stdint.h>

// =========================================================================
// STM32 peripheral register addresses used directly in this file
// =========================================================================

// RCC
#define RCC_AHB1ENR (*((volatile uint32_t *)0x40023830U))
#define RCC_APB1ENR (*((volatile uint32_t *)0x40023840U))
#define RCC_APB2ENR (*((volatile uint32_t *)0x40023844U))

// GPIOA (ADC input PA0)
#define GPIOA_MODER (*((volatile uint32_t *)0x40020000U))

// GPIOC (fire buttons PC6, PC8)
#define GPIOC_MODER (*((volatile uint32_t *)0x40020800U))
#define GPIOC_IDR (*((volatile uint32_t *)0x40020810U))

// ADC1
#define ADC1_SR (*((volatile uint32_t *)0x40012000U))
#define ADC1_CR1 (*((volatile uint32_t *)0x40012004U))
#define ADC1_CR2 (*((volatile uint32_t *)0x40012008U))
#define ADC1_SMPR2 (*((volatile uint32_t *)0x40012014U))
#define ADC1_SQR1 (*((volatile uint32_t *)0x4001202CU))
#define ADC1_SQR3 (*((volatile uint32_t *)0x40012034U))
#define ADC1_DR (*((volatile uint32_t *)0x4001204CU))
#define ADC_CCR (*((volatile uint32_t *)0x40012304U))

// SYSCFG (for EXTI routing)
#define SYSCFG_EXTICR2 (*((volatile uint32_t *)0x40013808U)) // EXTI4-7
#define SYSCFG_EXTICR3 (*((volatile uint32_t *)0x4001380CU)) // EXTI8-11

// EXTI
#define EXTI_IMR (*((volatile uint32_t *)0x40013C00U))
#define EXTI_RTSR (*((volatile uint32_t *)0x40013C08U))
#define EXTI_PR (*((volatile uint32_t *)0x40013C14U))

// NVIC
#define NVIC_ISER0 (*((volatile uint32_t *)0xE000E100U)) // IRQ0-31
#define SCB_SHPR3 (*((volatile uint32_t *)0xE000ED20U))

// SysTick
#define STK_CTRL (*((volatile uint32_t *)0xE000E010U))
#define STK_LOAD (*((volatile uint32_t *)0xE000E014U))
#define STK_VAL (*((volatile uint32_t *)0xE000E018U))

// =========================================================================
// Game global variables
// =========================================================================
volatile uint32_t ADCdata = 0; // raw 12-bit ADC result
volatile uint32_t playerPosition =
    0; // converted to 0-110 (player ship is 18 pixel)
volatile uint32_t playerFlag = 0;
volatile uint32_t laserFlag = 0;
volatile uint32_t missileFlag = 0;

uint32_t FrameCount = 0; // toggles 0->1->0->1 (2 animation poses)
uint32_t randomnum = 0;  // incremented by button press and game event
uint32_t currentLevel = 1;
uint32_t numEnemies = 8; // 4 top row + 4 bottom row

uint32_t playMissile = 8; // index into Missile[8] (0~7 used for enemies)
uint32_t playLaser = 8;   // index into Laser[8] (0~7 used for player)

int32_t enemyDir = 1; // +1 = moving right, -1 = moving left
uint32_t enemyDrop =
    0; // pixels to drop down this frame (0 = no drop, 2 = drop)

// =========================================================================
// BMP image data — identical to original (hardware-independent raw bytes)
// 4-bit indexed BMP, LM3S format; decoded by SSD1306_PrintBMP()
// =========================================================================

// enemy ship — top row, arms/mouth closed   (16×10)
const uint8_t SmallEnemy30PointA[] = {
    0x42, 0x4D, 0xC6, 0x00, 0x00, 0x00, 0x00, 0x00, 0x00, 0x00, 0x76, 0x00,
    0x00, 0x00, 0x28, 0x00, 0x00, 0x00, 0x10, 0x00, 0x00, 0x00, 0x0A, 0x00,
    0x00, 0x00, 0x01, 0x00, 0x04, 0x00, 0x00, 0x00, 0x00, 0x00, 0x50, 0x00,
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    0x00, 0x00, 0x00, 0x00, 0x00, 0x00, 0xFF};

// enemy ship — top row, arms/mouth open     (16×10)
const uint8_t SmallEnemy30PointB[] = {
    0x42, 0x4D, 0xC6, 0x00, 0x00, 0x00, 0x00, 0x00, 0x00, 0x00, 0x76, 0x00,
    0x00, 0x00, 0x28, 0x00, 0x00, 0x00, 0x10, 0x00, 0x00, 0x00, 0x0A, 0x00,
    0x00, 0x00, 0x01, 0x00, 0x04, 0x00, 0x00, 0x00, 0x00, 0x00, 0x50, 0x00,
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    0x00, 0x00, 0x00, 0x00, 0x00, 0x00, 0xFF};

// enemy ship — middle row, arms together    (16×10)
const uint8_t SmallEnemy20PointA[] = {
    0x42, 0x4D, 0xC6, 0x00, 0x00, 0x00, 0x00, 0x00, 0x00, 0x00, 0x76, 0x00,
    0x00, 0x00, 0x28, 0x00, 0x00, 0x00, 0x10, 0x00, 0x00, 0x00, 0x0A, 0x00,
    0x00, 0x00, 0x01, 0x00, 0x04, 0x00, 0x00, 0x00, 0x00, 0x00, 0x50, 0x00,
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    0x00, 0x00, 0x00, 0x00, 0x00, 0x00, 0xFF};

// enemy ship — middle row, arms apart       (16×10)
const uint8_t SmallEnemy20PointB[] = {
    0x42, 0x4D, 0xC6, 0x00, 0x00, 0x00, 0x00, 0x00, 0x00, 0x00, 0x76, 0x00,
    0x00, 0x00, 0x28, 0x00, 0x00, 0x00, 0x10, 0x00, 0x00, 0x00, 0x0A, 0x00,
    0x00, 0x00, 0x01, 0x00, 0x04, 0x00, 0x00, 0x00, 0x00, 0x00, 0x50, 0x00,
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    0x00, 0x00, 0x00, 0x00, 0x00, 0x00, 0xFF};

// enemy ship — bottom row, arms down        (16×10)
const uint8_t SmallEnemy10PointA[] = {
    0x42, 0x4D, 0xC6, 0x00, 0x00, 0x00, 0x00, 0x00, 0x00, 0x00, 0x76, 0x00,
    0x00, 0x00, 0x28, 0x00, 0x00, 0x00, 0x10, 0x00, 0x00, 0x00, 0x0A, 0x00,
    0x00, 0x00, 0x01, 0x00, 0x04, 0x00, 0x00, 0x00, 0x00, 0x00, 0x50, 0x00,
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    0x00, 0x00, 0x00, 0x00, 0x00, 0x00, 0xFF};

// enemy ship — bottom row, arms up          (16×10)
const uint8_t SmallEnemy10PointB[] = {
    0x42, 0x4D, 0xC6, 0x00, 0x00, 0x00, 0x00, 0x00, 0x00, 0x00, 0x76, 0x00,
    0x00, 0x00, 0x28, 0x00, 0x00, 0x00, 0x10, 0x00, 0x00, 0x00, 0x0A, 0x00,
    0x00, 0x00, 0x01, 0x00, 0x04, 0x00, 0x00, 0x00, 0x00, 0x00, 0x50, 0x00,
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    0x00, 0x00, 0x00, 0x00, 0x00, 0x00, 0xFF};

// player ship  (18×8, with 2 black erase columns each side)
const uint8_t PlayerShip0[] = {
    0x42, 0x4D, 0xD6, 0x00, 0x00, 0x00, 0x00, 0x00, 0x00, 0x00, 0x76, 0x00,
    0x00, 0x00, 0x28, 0x00, 0x00, 0x00, 0x12, 0x00, 0x00, 0x00, 0x08, 0x00,
    0x00, 0x00, 0x01, 0x00, 0x04, 0x00, 0x00, 0x00, 0x00, 0x00, 0x60, 0x00,
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    0x00, 0x00, 0x00, 0x00, 0x00, 0x00, 0x00, 0x00, 0x00, 0x00, 0xFF};

// bonus UFO  (20×7, with 2 black erase columns each side)
const uint8_t SmallEnemyBonus0[] = {
    0x42, 0x4D, 0xCA, 0x00, 0x00, 0x00, 0x00, 0x00, 0x00, 0x00, 0x76, 0x00,
    0x00, 0x00, 0x28, 0x00, 0x00, 0x00, 0x14, 0x00, 0x00, 0x00, 0x07, 0x00,
    0x00, 0x00, 0x01, 0x00, 0x04, 0x00, 0x00, 0x00, 0x00, 0x00, 0x54, 0x00,
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    0x00, 0x0F, 0xFF, 0xFF, 0xF0, 0x00, 0x00, 0x00, 0x00, 0x00, 0xFF};

// bunker — undamaged  (18×5)
const uint8_t Bunker0[] = {
    0x42, 0x4D, 0xB2, 0x00, 0x00, 0x00, 0x00, 0x00, 0x00, 0x00, 0x76, 0x00,
    0x00, 0x00, 0x28, 0x00, 0x00, 0x00, 0x12, 0x00, 0x00, 0x00, 0x05, 0x00,
    0x00, 0x00, 0x01, 0x00, 0x04, 0x00, 0x00, 0x00, 0x00, 0x00, 0x3C, 0x00,
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    0xAA, 0xAA, 0xAA, 0xAA, 0xAA, 0xAA, 0x00, 0x00, 0x00, 0x00, 0xFF};

// bunker — slight damage  (18×5)
const uint8_t Bunker1[] = {
    0x42, 0x4D, 0xB2, 0x00, 0x00, 0x00, 0x00, 0x00, 0x00, 0x00, 0x76, 0x00,
    0x00, 0x00, 0x28, 0x00, 0x00, 0x00, 0x12, 0x00, 0x00, 0x00, 0x05, 0x00,
    0x00, 0x00, 0x01, 0x00, 0x04, 0x00, 0x00, 0x00, 0x00, 0x00, 0x3C, 0x00,
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    0xA0, 0xA0, 0x00, 0x0A, 0x0A, 0x0A, 0x00, 0x00, 0x00, 0x00, 0xFF};

// bunker — heavy damage   (18×5)
const uint8_t Bunker2[] = {
    0x42, 0x4D, 0xB2, 0x00, 0x00, 0x00, 0x00, 0x00, 0x00, 0x00, 0x76, 0x00,
    0x00, 0x00, 0x28, 0x00, 0x00, 0x00, 0x12, 0x00, 0x00, 0x00, 0x05, 0x00,
    0x00, 0x00, 0x01, 0x00, 0x04, 0x00, 0x00, 0x00, 0x00, 0x00, 0x3C, 0x00,
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    0xA0, 0x00, 0x00, 0x0A, 0x00, 0x00, 0x00, 0x00, 0x00, 0x00, 0xFF};

// bunker — destroyed (blank)  (18×5)
const uint8_t Bunker3[] = {
    0x42, 0x4D, 0xB2, 0x00, 0x00, 0x00, 0x00, 0x00, 0x00, 0x00, 0x76, 0x00,
    0x00, 0x00, 0x28, 0x00, 0x00, 0x00, 0x12, 0x00, 0x00, 0x00, 0x05, 0x00,
    0x00, 0x00, 0x01, 0x00, 0x04, 0x00, 0x00, 0x00, 0x00, 0x00, 0x3C, 0x00,
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    0x00, 0x00, 0x00, 0x00, 0x00, 0x00, 0x00, 0x00, 0x00, 0x00, 0xFF};

// large explosion, frame 0  (18×8)
const uint8_t BigExplosion0[] = {
    0x42, 0x4D, 0xD6, 0x00, 0x00, 0x00, 0x00, 0x00, 0x00, 0x00, 0x76, 0x00,
    0x00, 0x00, 0x28, 0x00, 0x00, 0x00, 0x12, 0x00, 0x00, 0x00, 0x08, 0x00,
    0x00, 0x00, 0x01, 0x00, 0x04, 0x00, 0x00, 0x00, 0x00, 0x00, 0x60, 0x00,
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    0x09, 0x00, 0x00, 0x00, 0x90, 0x00, 0x0A, 0x00, 0x00, 0x00, 0xFF};

// large explosion, frame 1  (18×8)
const uint8_t BigExplosion1[] = {
    0x42, 0x4D, 0xD6, 0x00, 0x00, 0x00, 0x00, 0x00, 0x00, 0x00, 0x76, 0x00,
    0x00, 0x00, 0x28, 0x00, 0x00, 0x00, 0x12, 0x00, 0x00, 0x00, 0x08, 0x00,
    0x00, 0x00, 0x01, 0x00, 0x04, 0x00, 0x00, 0x00, 0x00, 0x00, 0x60, 0x00,
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    0x0A, 0x00, 0x90, 0x00, 0xB0, 0x00, 0x09, 0x00, 0x00, 0x00, 0xFF};

// small explosion  (16×10)
const uint8_t SmallExplosion0[] = {
    0x42, 0x4D, 0xC6, 0x00, 0x00, 0x00, 0x00, 0x00, 0x00, 0x00, 0x76, 0x00,
    0x00, 0x00, 0x28, 0x00, 0x00, 0x00, 0x10, 0x00, 0x00, 0x00, 0x0A, 0x00,
    0x00, 0x00, 0x01, 0x00, 0x04, 0x00, 0x00, 0x00, 0x00, 0x00, 0x50, 0x00,
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    0x00, 0x00, 0x00, 0x00, 0x00, 0x00, 0xFF};

// small explosion blank (erase)  (16×10)
const uint8_t SmallExplosion1[] = {
    0x42, 0x4D, 0xC6, 0x00, 0x00, 0x00, 0x00, 0x00, 0x00, 0x00, 0x76, 0x00,
    0x00, 0x00, 0x28, 0x00, 0x00, 0x00, 0x10, 0x00, 0x00, 0x00, 0x0A, 0x00,
    0x00, 0x00, 0x01, 0x00, 0x04, 0x00, 0x00, 0x00, 0x00, 0x00, 0x50, 0x00,
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    0x00, 0x00, 0x00, 0x00, 0x00, 0x00, 0xFF};

// player missile in flight  (4×9)
const uint8_t Missile0[] = {
    0x42, 0x4D, 0x9A, 0x00, 0x00, 0x00, 0x00, 0x00, 0x00, 0x00, 0x76, 0x00,
    0x00, 0x00, 0x28, 0x00, 0x00, 0x00, 0x04, 0x00, 0x00, 0x00, 0x09, 0x00,
    0x00, 0x00, 0x01, 0x00, 0x04, 0x00, 0x00, 0x00, 0x00, 0x00, 0x24, 0x00,
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    0x00, 0x00, 0x0F, 0x00, 0x00, 0x00, 0x00, 0x00, 0x00, 0x00, 0xFF};

// player missile alternate  (4×9)
const uint8_t Missile1[] = {
    0x42, 0x4D, 0x9A, 0x00, 0x00, 0x00, 0x00, 0x00, 0x00, 0x00, 0x76, 0x00,
    0x00, 0x00, 0x28, 0x00, 0x00, 0x00, 0x04, 0x00, 0x00, 0x00, 0x09, 0x00,
    0x00, 0x00, 0x01, 0x00, 0x04, 0x00, 0x00, 0x00, 0x00, 0x00, 0x24, 0x00,
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    0x00, 0x00, 0x00, 0xF0, 0x00, 0x00, 0x00, 0x00, 0x00, 0x00, 0xFF};

// missile blank (erase)  (4×9)
const uint8_t Missile2[] = {
    0x42, 0x4D, 0x9A, 0x00, 0x00, 0x00, 0x00, 0x00, 0x00, 0x00, 0x76, 0x00,
    0x00, 0x00, 0x28, 0x00, 0x00, 0x00, 0x04, 0x00, 0x00, 0x00, 0x09, 0x00,
    0x00, 0x00, 0x01, 0x00, 0x04, 0x00, 0x00, 0x00, 0x00, 0x00, 0x24, 0x00,
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    0x00, 0x00, 0x00, 0x00, 0x00, 0x00, 0x00, 0x00, 0x00, 0x00, 0xFF};

// laser burst  (2×9)
const uint8_t Laser0[] = {
    0x42, 0x4D, 0x9A, 0x00, 0x00, 0x00, 0x00, 0x00, 0x00, 0x00, 0x76, 0x00,
    0x00, 0x00, 0x28, 0x00, 0x00, 0x00, 0x02, 0x00, 0x00, 0x00, 0x09, 0x00,
    0x00, 0x00, 0x01, 0x00, 0x04, 0x00, 0x00, 0x00, 0x00, 0x00, 0x24, 0x00,
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    0x00, 0x00, 0xFF, 0x00, 0x00, 0x00, 0x00, 0x00, 0x00, 0x00, 0xFF};

// laser blank (erase)  (2×9)
const uint8_t Laser1[] = {
    0x42, 0x4D, 0x9A, 0x00, 0x00, 0x00, 0x00, 0x00, 0x00, 0x00, 0x76, 0x00,
    0x00, 0x00, 0x28, 0x00, 0x00, 0x00, 0x02, 0x00, 0x00, 0x00, 0x09, 0x00,
    0x00, 0x00, 0x01, 0x00, 0x04, 0x00, 0x00, 0x00, 0x00, 0x00, 0x24, 0x00,
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    0x00, 0x00, 0x00, 0x00, 0x00, 0x00, 0x00, 0x00, 0x00, 0x00, 0xFF};

// =========================================================================
// ADC (STM32 ADC1 CH0 on PA0)
// =========================================================================

static void ADC0_Init(void) {
  RCC_AHB1ENR |= (1U << 0);
  GPIOA_MODER |= (3U << 0);

  RCC_APB2ENR |= (1U << 8);
  ADC_CCR &= ~(3U << 16);

  ADC1_CR1 = 0U;
  ADC1_CR2 = 0U;
  ADC1_SQR1 = 0U;
  ADC1_SQR3 = 0U;
  ADC1_SMPR2 = (7U << 0);

  ADC1_CR2 |= (1U << 0);
  for (volatile uint32_t d = 0; d < 10000U; d++)
    ;
}

static uint32_t ADC0_In(void) {
  ADC1_CR2 |= (1U << 30);
  while (!(ADC1_SR & (1U << 1)))
    ;
  return ADC1_DR & 0xFFFU;
}

// =========================================================================
// SysTick at 30Hz (16 MHz / 30 = 533333)
// Sending 1024 bytes over I2C at ~381 kHz (16MHz/42),
// 1024 * 9 / 381,000 ~ 24 ms per frame
// =========================================================================
static void SysTick_Init_30Hz(void) {
  STK_CTRL = 0U;
  STK_VAL = 0U;
  STK_LOAD = 533332U; // 16,000,000 / 30 -1 = 533332
  SCB_SHPR3 = (SCB_SHPR3 & 0x00FFFFFF) | (2U << 29); // priority 2
  STK_CTRL = 0x7U; // enable systick, enable interrupt, use processor clock
}

// =========================================================================
// Fire buttons: PC6 = missile, PC8 = laser
// Both are rising-edge, external pull-down to GND
// =========================================================================
static void Switch_Init(void) {
  RCC_AHB1ENR |= (1U << 2); // enable GPIOC
  GPIOC_MODER &= ~((3U << 12) | (3U << 16));

  RCC_APB2ENR |= (1U << 14);

  // Route PC6
  SYSCFG_EXTICR2 &= ~(0xFU << 8);
  SYSCFG_EXTICR2 |= (2U << 8);

  // Route PC8
  SYSCFG_EXTICR3 &= ~(0xFU << 0);
  SYSCFG_EXTICR3 |= (2U << 0);

  // Unmask EXTI6 and EXTI8
  EXTI_IMR |= (1U << 6) | (1U << 8);
  // Rising-edge trigger for EXTI6 and EXTI8
  EXTI_RTSR |= (1U << 6) | (1U << 8);
  // Clear any pending flags
  EXTI_PR = (1U << 6) | (1U << 8);

  // Enable EXTI9_5 in NVIC (IRQ23, in ISER0 bit 23)
  NVIC_ISER0 |= (1U << 23);
}

// =========================================================================
// Convert - ADC 12-bit -> player X position
// =========================================================================
static uint32_t Conver(uint32_t sample) { return (110U * sample) / 4095U; }

// =========================================================================
// Capture BMP dimensions from header bytes (width=ptr[18], height=ptr[22])
// =========================================================================
#define BUNKERW ((uint8_t)Bunker0[18])
#define BUNKERH ((uint8_t)Bunker0[22])
#define ENEMY30W ((uint8_t)SmallEnemy30PointA[18])
#define ENEMY30H ((uint8_t)SmallEnemy30PointA[22])
#define ENEMY20W ((uint8_t)SmallEnemy20PointA[18])
#define ENEMY20H ((uint8_t)SmallEnemy20PointA[22])
#define ENEMY10W ((uint8_t)SmallEnemy10PointA[18])
#define ENEMY10H ((uint8_t)SmallEnemy10PointA[22])
#define ENEMYBONUSW ((uint8_t)SmallEnemyBonus0[18])
#define ENEMYBONUSH ((uint8_t)SmallEnemyBonus0[22])
#define LASERW ((uint8_t)Laser0[18])
#define LASERH ((uint8_t)Laser0[22])
#define MISSILEW ((uint8_t)Missile0[18])
#define MISSILEH ((uint8_t)Missile0[22])
#define PLAYERW ((uint8_t)PlayerShip0[18])
#define PLAYERH ((uint8_t)PlayerShip0[22])
// =========================================================================
// Game object initializers
// =========================================================================
typedef struct {
  uint32_t x;
  uint32_t maxpoint[2]; // range of x and y values
  uint32_t y;
  const uint8_t *image[4]; // ptr->image
  int32_t life;            // 0=dead, 1=alive
  uint32_t deathCounter;   // number of cycles to show the explosion BMP image
} STyp;

STyp Enemy[8];
STyp Bunker;
STyp Player;
STyp Missile[9]; // [0-7] = enemy missiles, [8] = player missile
STyp Laser[9];   // [0-7] = enemy lasers, [8] = player laser
STyp UFO;

void UFO_Init(void) {
  UFO.x = 0;
  UFO.y = 10;
  UFO.maxpoint[0] = UFO.x + ENEMYBONUSW;
  UFO.maxpoint[1] = UFO.y + ENEMYBONUSH;
  UFO.image[0] = SmallEnemyBonus0;
  UFO.image[1] = SmallExplosion0;
  UFO.life = 1;
  UFO.deathCounter = 3;
  Sound_Highpitch();
}

void UFO_Move(void) {
  if (UFO.life > 0 && UFO.x < 126U) { // 126 = SCREENW-2
    UFO.x += 3;
    UFO.maxpoint[0] += 3;
  } else {
    UFO.life = 0;
  }
}

// 8 enemies arranged in 2 rows × 4 columns near the top of the 128×64 screen
void Enemy_Init(void) {
  int i;
  for (i = 0; i < (int)numEnemies; i++) {
    // Spacing = 15 pixels. Enemy width = 16 pixels → enemies overlap by 1
    // pixel, which is tight but intentional
    Enemy[i].x = 15U * (uint32_t)(i % 4);
    if (i < 4) { // row 0 - y=10 from top
      Enemy[i].y = 10;
      // top-left     = (Enemy[i].x, Enemy[i].y)
      // bottom-right = (Enemy[i].maxpoint[0], Enemy[i].maxpoint[1])
      Enemy[i].maxpoint[0] = Enemy[i].x + ENEMY30W; // right edge = x + 16
      Enemy[i].maxpoint[1] = Enemy[i].y + ENEMY30H; // bottom edge = y + 10
      Enemy[i].image[0] = SmallEnemy30PointA;       // animation frame 0
      Enemy[i].image[1] = SmallEnemy30PointB;       // animation frame 1
    } else if (i >= 4 || i < 8) {
      Enemy[i].y = 10 + ENEMY30H; // row 1 - y=10+10=20
      Enemy[i].maxpoint[0] = Enemy[i].x + ENEMY10W;
      Enemy[i].maxpoint[1] = Enemy[i].y + ENEMY10H;
      Enemy[i].image[0] = SmallEnemy10PointA;
      Enemy[i].image[1] = SmallEnemy10PointB;
    } else { // dead code (never reached with numEnumies=8)
      Enemy[i].y = 10 + ENEMY30H + ENEMY20H;
      Enemy[i].maxpoint[0] = Enemy[i].x + ENEMY20W;
      Enemy[i].maxpoint[1] = Enemy[i].y + ENEMY20H;
      Enemy[i].image[0] = SmallEnemy20PointA;
      Enemy[i].image[1] = SmallEnemy20PointB;
    }
    Enemy[i].life = 1;         // alive
    Enemy[i].deathCounter = 3; // 3 frames of death animation
  }
}

void Enemy_Move(void) {
  int i;
  int minY = 64;
  for (i = 0; i < (int)numEnemies; i++) {
    Enemy[i].x += (uint32_t)enemyDir;           // horizontal: +1 right, -1 left
    Enemy[i].maxpoint[0] += (uint32_t)enemyDir; // keep bounding box in sync
    Enemy[i].y += enemyDrop;                    // vertical: 0=stay, 2=drop
    Enemy[i].maxpoint[1] += enemyDrop;          // keep bouding box in sync
    if ((int)Enemy[i].y < minY) {               // track highest enemy
      minY = (int)Enemy[i].y;
    }
  }
  // reset: drop only happens for exactly one frame
  enemyDrop = 0;
  for (i = 0; i < (int)numEnemies; i++) {
    if (Enemy[i].life > 0) {
      if (Enemy[i].maxpoint[0] >= 126U) {        // right edge hit right wall
        enemyDir = (-1) * (int32_t)currentLevel; // reverse direction
        enemyDrop = 2;                           // schedule a drop
      }
      if (Enemy[i].x <= 0U) { // left edge hit left wall
        enemyDir = 1 * (int32_t)currentLevel;
        enemyDrop = 2;
      }
    }
  }

  // enemies are not too close to the top
  // no UFO already on screen
  // rare random window
  if (minY > 20 && UFO.life <= 0 && randomnum > 8 && randomnum <= 10) {
    UFO_Init();
  }
}

void Bunker_Init(void) {
  Bunker.x = 55U;           // centered: (128-18)/2 = 55
  Bunker.y = 63U - PLAYERH; // just above player (63 = bottom)
  Bunker.maxpoint[0] = Bunker.x + BUNKERW;
  Bunker.maxpoint[1] = Bunker.y + BUNKERH;
  Bunker.image[0] = Bunker0; // full bunker
  Bunker.image[1] = Bunker1; // slight damage craters
  Bunker.image[2] = Bunker2; // heavily eroded
  Bunker.image[3] = Bunker3; // blank
  Bunker.life = 10;          // bunker survives exactly 5 enemy missiles
}

void Player_Init(void) {
  Player.x = 55U;
  Player.y = 63U;
  Player.maxpoint[0] = Player.x + PLAYERW;
  Player.maxpoint[1] = Player.y + PLAYERH;
  Player.image[0] = PlayerShip0;
  Player.image[1] = BigExplosion0;
  Player.life = 20;
  Player.deathCounter = 3;
}

void Player_Move(uint32_t position) {
  Player.x = position;
  Player.maxpoint[0] = Player.x + PLAYERW;
}

void Player_Missile_Init(void) {
  // center of player ship
  Missile[playMissile].x = Player.x + (PLAYERW / 2U);
  // slightly above the player's base row
  Missile[playMissile].y = Player.y - 4U;
  // sets the right and bottom edges of the collision box
  Missile[playMissile].maxpoint[0] = Missile[playMissile].x + MISSILEW;
  Missile[playMissile].maxpoint[1] = Missile[playMissile].y + MISSILEH;
  Missile[playMissile].image[0] = Missile0;
  Missile[playMissile].image[1] = Missile2;
  Missile[playMissile].life = 1;
  Missile[playMissile].deathCounter = 3;
}

void Enemy_Missile_Init(void) {
  int i;
  for (i = 0; i < (int)numEnemies; i++) {
    // randomnum ensures enemies don't all fire simultaneously
    // (i + 2) keep missile and laser offsets different
    // the shared randomnum approach makes simultaneous firing mathematically
    // impossible
    if ((Enemy[i].life > 0) && (Missile[i].life <= 0) &&
        ((i + 2) == (int)randomnum)) {
      // only the front-row enemy in each column can fire.
      if ((i >= 4) || (Enemy[i % 4].life <= 0)) {
        Missile[i].x = Enemy[i].x + (ENEMY30W / 2U);
        Missile[i].y = Enemy[i].y + 4U;
        Missile[i].maxpoint[0] = Missile[i].x + MISSILEW;
        Missile[i].maxpoint[1] = Missile[i].y + MISSILEH;
        Missile[i].image[0] = Missile0;
        Missile[i].image[1] = Missile2;
        Missile[i].life = 1;
        Missile[i].deathCounter = 3;
      }
    }
  }
}

void Missile_Move(void) {
  if ((Missile[playMissile].life == 1) && (Missile[playMissile].y <= 64U)) {
    Missile[playMissile].y -= 3U;
    Missile[playMissile].maxpoint[1] -= 3U;
  } else {
    Missile[playMissile].life = 0;
  }
}

void Enemy_Missile_Move(void) {
  int i;
  for (i = 0; i < (int)numEnemies; i++) {
    if ((Missile[i].life == 1) && (Missile[i].y <= 64U)) {
      Missile[i].y += 3U;
      Missile[i].maxpoint[1] += 3U;
    } else {
      Missile[i].life = 0;
    }
  }
}

void Player_Laser_Init(void) {
  Laser[playLaser].x = Player.x + (PLAYERW / 2U);
  Laser[playLaser].y = Player.y - 4U;
  Laser[playLaser].maxpoint[0] = Laser[playLaser].x + LASERW;
  Laser[playLaser].maxpoint[1] = Laser[playLaser].y + LASERH;
  Laser[playLaser].image[0] = Laser0;
  Laser[playLaser].image[1] = Laser1;
  Laser[playLaser].life = 1;
  Laser[playLaser].deathCounter = 3;
  Sound_Shoot();
}

void Enemy_Laser_Init(void) {
  int i;
  for (i = 0; i < (int)numEnemies; i++) {
    if ((Enemy[i].life > 0) && (Laser[i].life <= 0) &&
        ((i + 3) == (int)randomnum)) {
      if ((i >= 4) || (Enemy[i % 4].life <= 0)) {
        Laser[i].x = Enemy[i].x + (ENEMY30W / 2U);
        Laser[i].y = Enemy[i].y + 4U;
        Laser[i].maxpoint[0] = Laser[i].x + LASERW;
        Laser[i].maxpoint[1] = Laser[i].y + LASERH;
        Laser[i].image[0] = Laser0;
        Laser[i].image[1] = Laser1;
        Laser[i].life = 1;
        Laser[i].deathCounter = 3;
      }
    }
  }
}

void Laser_Move(void) {
  if ((Laser[playLaser].life == 1) && (Laser[playLaser].y <= 64U)) { // was 48
    Laser[playLaser].y -= 4U;
    Laser[playLaser].maxpoint[1] -= 4U;
  } else {
    Laser[playLaser].life = 0;
  }
}

void Enemy_Laser_Move(void) {
  int i;
  for (i = 0; i < (int)numEnemies; i++) {
    if ((Laser[i].life == 1) && (Laser[i].y <= 64U)) { // was 48
      Laser[i].y += 4U;
      Laser[i].maxpoint[1] += 4U;
    } else {
      Laser[i].life = 0;
    }
  }
}

// =============================
// Check_Damage - collision detection
// =============================
void Check_Damage(void) {
  int i, j;

  // enemy missiles / lasers vs bunker
  for (j = 0; j < (int)numEnemies; j++) {
    // bunker's collision box is 2 pixels wider on each side
    // only the bottom 10 rows of the bunker receive enemy fire
    if ((Missile[j].life == 1) && (Bunker.life > 0) &&
        ((Bunker.x - 2U) <= Missile[j].x) &&
        (Missile[j].x <= (Bunker.maxpoint[0] + 2U)) &&
        ((Bunker.y + 10U) <= Missile[j].maxpoint[1])) {
      Bunker.life -= 2;
      Missile[j].life = 0;
    }
    if ((Laser[j].life == 1) && (Bunker.life > 0) &&
        ((Bunker.x - 2U) <= Laser[j].x) &&
        (Laser[j].x <= (Bunker.maxpoint[0] + 2U)) &&
        ((Bunker.y + 10U) <= Laser[j].maxpoint[1])) {
      Bunker.life -= 1;
      Laser[j].life = 0;
    }
  }
  // player missile vs bunker
  // the player fires upward and
  // the missile/laser bottom would hit the bunker from below.
  if ((Missile[playMissile].life == 1) && (Bunker.life > 0) &&
      ((Bunker.x - 2U) <= Missile[playMissile].x) &&
      (Missile[playMissile].x <= (Bunker.maxpoint[0] + 2U))) {
    Bunker.life -= 2;
    Missile[playMissile].life = 0;
  }
  // player laser vs bunker
  if ((Laser[playMissile].life == 1) && (Bunker.life > 0) &&
      ((Bunker.x - 2U) <= Laser[playLaser].x) &&
      (Laser[playLaser].x <= (Bunker.maxpoint[0] + 2U))) {
    Bunker.life -= 1;
  }

  // enemy missiles/lasers vs player
  for (j = 0; j < (int)numEnemies; j++) {
    if ((Missile[j].life == 1) && (Player.life > 0) &&
        (Player.x <= Missile[j].x) && (Missile[j].x <= Player.maxpoint[0]) &&
        (Player.y <= Missile[j].maxpoint[1])) {
      Player.life -= 2;
      Missile[j].life = 0;
      Sound_Explosion();
    }

    if ((Laser[j].life == 1) && (Player.life > 0) && (Player.x <= Laser[j].x) &&
        (Laser[j].x <= Player.maxpoint[0]) &&
        (Player.y <= Laser[j].maxpoint[1])) {
      Player.life -= 1;
      Laser[j].life = 0;
      Sound_Explosion();
    }
  }

  // player missile/laser vs enemies
  for (i = 0; i < (int)numEnemies; i++) {
    if ((Missile[playMissile].life == 1) && (Enemy[i].life > 0) &&
        (Enemy[i].x <= Missile[playMissile].x) &&
        (Missile[playMissile].x <= Enemy[i].maxpoint[0]) &&
        (Enemy[i].y <= Missile[playMissile].y) &&
        (Missile[playMissile].y <= Enemy[i].maxpoint[1])) {
      Enemy[i].life -= 1;
      Missile[playMissile].life = 0;
      Sound_Killed();
    }
    if ((Laser[playLaser].life == 1) && (Enemy[i].life > 0) &&
        (Enemy[i].x <= Laser[playLaser].x) &&
        (Laser[playLaser].x <= Enemy[i].maxpoint[0]) &&
        (Enemy[i].y <= Laser[playLaser].y) &&
        (Laser[playLaser].y <= Enemy[i].maxpoint[1])) {
      Enemy[i].life -= 1;
      Laser[playLaser].life = 0;
      Sound_Killed();
    }
    if (Enemy[i].life <= 0) {
      Enemy[i].image[0] = SmallExplosion0;
      Enemy[i].image[1] = SmallExplosion1;
      if (Enemy[i].deathCounter > 0) {
        Enemy[i].deathCounter--;
      }
    }
  }

  // player missile/laser vs enemy missiles/lasers
  for (i = 0; i < (int)numEnemies; i++) {
    if ((Missile[playMissile].life == 1) &&
        (Missile[i].x <= Missile[playMissile].x) &&
        (Missile[playMissile].x <= Missile[i].maxpoint[0]) &&
        (Missile[i].y <= Missile[playMissile].y) &&
        (Missile[playMissile].y <= Missile[i].maxpoint[1])) {
      Missile[i].life = 0;
      Missile[playMissile].life = 0;
    }
    if ((Laser[playLaser].life == 1) && (Laser[i].x <= Laser[playLaser].x) &&
        (Laser[playLaser].x <= Laser[i].maxpoint[0]) &&
        (Laser[i].y <= Laser[playLaser].y) &&
        (Laser[playLaser].y <= Laser[i].maxpoint[1])) {
      Laser[i].life = 0;
      Laser[playLaser].life = 0;
    }
  }

  // player death state
  if (Player.life <= 0) {
    Player.image[0] = BigExplosion0;
    Player.image[1] = BigExplosion1;
    if (Player.deathCounter > 0) {
      Player.deathCounter--;
    }
  }

  // player missile/laser vs UFO
  if ((Missile[playMissile].life == 1) && (UFO.life > 0) &&
      (UFO.x <= Missile[playMissile].x) &&
      (Missile[playMissile].x <= UFO.maxpoint[0]) &&
      (UFO.y <= Missile[playMissile].y) &&
      (Missile[playMissile].y <= UFO.maxpoint[1])) {
    UFO.life -= 2;
    Missile[playMissile].life = 0;
    Sound_Killed();
  }
  if ((Laser[playLaser].life == 1) && (UFO.life > 0) &&
      (UFO.x <= Laser[playLaser].x) &&
      (Laser[playLaser].x <= UFO.maxpoint[0]) &&
      (UFO.y <= Laser[playLaser].y) &&
      (Laser[playLaser].y <= UFO.maxpoint[1])) {
    UFO.life -= 1;
    Laser[playLaser].life = 0;
    Sound_Killed();
  }

  if (UFO.life <= 0) {
    UFO.image[0] = SmallExplosion0;
    UFO.image[1] = SmallExplosion1;
    if (UFO.deathCounter > 0) {
      UFO.deathCounter--;
    }
  }
}